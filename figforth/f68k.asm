
*  OPT <OPTIONS> 
* NAM  "68000 FIG-FORTH 1.0 DECEMBER 1982"
*
* FIG-FORTH  RELEASE 1.0  FOR THE 68000 PROCESSOR
*
* ALL PUBLICATIONS OF THE FORTH INTEREST GROUP
* ARE PUBLIC DOMAIN. THEY MAY BE FURTHER
* DISTRIBUTED BY THE INCLUSION OF THIS CREDIT
* NOTICE:
*
* THIS PUBLICATION HAS BEEN MADE AVAILABLE BY THE
*  FORTH INTEREST GROUP
*  P.O. BOX 1105
*  SAN CARLOS, CA 94070
*
* IMPLEMENTATION BY:
*  KENNETH MANTEI
*  DEPARTMENT OF CHEMISTRY
*  CALIFORNIA STATE COLLEGE
*  SAN BERNARDINO, CALIFORNIA 92407
*
***********************************************
*
* ADAPTED FOR THE MOTOROLA ASSEMBLER BY:
*  ALBERT VAN DER HORST
*  ARIE KATTENBERG
*  FIG CHAPTER HOLLAND, WHICH IS
*  A USER GROUP OF
*  HCCH ( HOBBY COMPUTER CLUB HOLLAND)
*  PETER NOY
*  68000 USER GROUP OF HCCH
*
* >> WARNING :
* THIS IS INTENDED TO BE A BYTE FOR BYTE RENDITION
*  OF THE FORTH AS IMPLEMENTED BY KENNETH MANTEI
*  THAT CONTAINS A FEW SUBSTANTIAL DEVIATIONS FROM THE
*  FIG MODEL AS MENTIONED IN THE ACCOMPANYING NOTE
*
* SOME LINES ARE PRECEEDED WITH *F
* THIS IS FOR THOSE WHO WANT TO FOLLOW THE
*       FIG MODEL MORE CLOSELY THAN IN THE ORIGINAL
*       68000 FIG FORTH 1.0
*
******************************************************
*
* SEE ALSO:
*  RELEASE & VERSION NUMBERS
*  ASCII CHARACTER EQUATES
*  MEMORY ALLOCATION
*  DISK INTERFACE
*  CONSOLE & PRINTER INTERFACE
*
* PAGE
*
*--------------------------------------------------------
*
* RELEASE & VERSION NUMBERS
*
FIGREL	EQU	1	*FIG RELEASE #
FIGREV	EQU	0	*FIG REVISION #
USRVER	EQU	0	*USER VERSION #
*
* ASCII CHARACTERS USED
*
ACR	EQU	$0D	*CARRIAGE RETURN
BELL	EQU	$07	*(^G)
BSIN	EQU	$7F	*INPUT BACKSPACE
BSOUT	EQU	$08	*OUTPUT BACKSPACE (^H)
LF	EQU	$0A	*LINE FEED
FF	EQU	$0C	*FORM FEED (^L)
*
* MEMORY ALLOCATION
*
BM	EQU	$1000		*BOTTOM OF MEMORY
EM	EQU	$4800		*TOP OF MEMORY
NSCR	EQU	2		*NUMBER OF 1024 BYTE SCREENS
KBBUF	EQU	256		*DATA BYTES PER DISK BUFFER
BSCRN	EQU	$400/KBBUF	* BUFFERS/SCREEN
RTS	EQU	$200		*USER PAGE & RETURN STACK SPACE
USS	EQU	$1E0		*USER STACK SPACE & TERM BUFFER SPACE
*
CO	EQU	KBBUF+4		*DISK BUFFER + 2 HEADER + 2 TAIL
NBUF	EQU	NSCR*BSCRN	*NUMBER OF BUFFERS
BUF1	EQU	BM		*ADDR FIRST DISK BUFFER
BUFE	EQU	BM+NBUF*CO	* END OF DISK BUFFERS
INITS0	EQU	BUFE+USS-2	*(S0)
USPAG	EQU	BUFE+USS	* USER PAGE
INITR0	EQU	USPAG+RTS-2	*(R0)
*
* PAGE
*
*--------------------------------------------------------
*
* THE FOLLOWING IS LEFT FOR THOSE WHO
* WANT TO FOLLOW THE FIG MODEL MORE CLOSELY
*
*F	JMP CLD	*VECTOR TO COLD START
*F	NOP	
*F	JMP	WRM	*VECTOR TO WARM START
*F	DC.B	FIGREL	*FIG RELEASE #
*F	DC.B	FIGREV	*FIG REVISION #
*F	DC.B	USRVER	*USER VERSION #
*F	DC.B	$0E	*IMPLEMENTATION ATTRIBUTES
*F	DC.W	TASK-7	*TOPMOST WORD IN FORTH VOCABULARY
*F	DC.W	BSIN	*BKSPACE CHARACTER
*F	DC.W	INITR0	*INIT (UP)
*F<<<<<< FOLLOWING USED BY COLD:
* MUST BE IN SAME ORDER AS USERVARIABLES
*F	DC.W	INITS0	*INIT (S0)
*F	DC.W	INITR0	*INIT (R0)
*F	DC.W	INITS0	*INIT (TIB)
*F	DC.W	$1F 	*INIT (WIDTH)
*F	DC.W	1 	*INIT (WARNING)
*F	DC.W	INITDP 	*INIT (FENCE)
*F	DC.W	INITDP 	*INIT (DP)
*F	DC.W	FORTH+8 	*INIT (VOC-LINK)
*F<<<<<< END DATA USED BY COLD
*F	DC.L	10450944	*CPU NAME (HW,LW)
*			(32 BIT, BASE 36 INTEGER)
*F
*
*--------------------------------------------------------
*
* FORTH REGISTERS
*
* FORTH 68000 FORTH PRESERVATION RULES
* ----- ---- ------------------------
*  SP    A3   SHOULD BE USED ONLY AS DATA STACK
*              ACROSS FORTH WORDS
*              GROWS TOWARDS LOW MEMORY
*  IP    A4   SHOULD BE PRESERVED ACROSS
*              FORTH WORDS
*  W     A5   WORD POINTER, LOADED VIA IP
*  UP    A6   POINTS TO THE USER BLOCK
*  RP    A7   RETURN STACK POINTER
*              GROWS TOWARDS LOW MEMORY
*
* ALL FORTH REGISTERS SHOULD BE PRESERVED
*       ACROSS CODE WORDS.
*
*--------------------------------------------------------
*
*	COMMENT CONVENTIONS:
*
*	=	MEANS	"IS EQUAL TO"
*	<-	MEANS ASSIGNMENT
*
*	NAME	=	ADDRESS OF NAME
*	(NAME)	=	CONTENTS AT NAME
*	((NAME))=	INDIRECT CONTENTS
*
*	CFA	=	ADDRESS OF CODE FIELD
*	LFA	=	ADDRESS 	OF LINK FIELD
*	NFA	=	ADDRESS OF START OF NAME FIELD
*	PFA	=	ADDRESS OF START OF PARAMETER FIELD
*
*	S1	=	ADDR OF 1ST WORD OF PARAMETER STACK
*	S2	=	ADDR OF 2VD WORD OF PARAMETER STACK
*	R1	=	ADDR OF 1ST WORD OF RETURN STACK
*	R2	=	ADDR OF 2ND WORD OF RETURN STACK
*	( ABOVE STACK POSITIONS VALID BEFORE & AFTER EXECUTION
*       OF ANY WORD, NOT DURING.)
*
*	LSB	=	LEAST SIGNIFICANT BIT
*	MSB	=	MOST SIGNIFICANT BIT
*	LB	=	LOW BYTE
*	HB	=	HIGH BYTE
*	LW	=	LOW WORD
*	HW	=	HIGH WORD
*	(MAY BE USED AS SUFFIX TO ABOVE NAMES)
* PAGE
*
*--------------------------------------------------------
*
* NEXT, THE FORTH ADDRESS INTERPRETER
* IS APPENDED TO EACH LOW LEVEL WORD
*
* PAGE
*
*  FORTH DICTIONARY
*
*
* DICTIONARY FORMAT:
*
*				BYTE
*	ADDRESS	NAME		CONTENTS
*	-------	----		--------
* 				OPTIONAL 0 BYTE
*				WHEN LENGTH OF NAME FIELD WOULD
*				BE ODD
*					( MSB=1
*					( P=PRECEDENCE BIT
*					( S=SMUDGE BIT
*	NFA	NAME FIELD	1PS<LEN> < NAME LENGTH
*				0<1CHAR> MSB=0, NAME'S 1ST CHAR
*				0<2CHAR>
*				...
*				1<LCHAR> MSB=1, NAME'S LAST CHR
*	LFA	LINK FIELD	<LINKHB> = PREVIOUS WORD'S NFA
*				<LINKLB>
*LABEL:	CFA	CODE FIELD	<CODEHB> = ADDR CPU CODE
*				<CODELB>
*	PFA	PARAMETER	<1PARAM> 1ST PARAMETER BYTE
*		FIELD		<2PARAM>
*                                 ...
*
*
*-------------------------------------------------------------
*
	ORG	USPAG+RTS
IOARE

*
* THE I/O ROUTINE PART IS SYSTEM DEPENDANT
*
* THE FOLLOWING GIVES AN EXAMPLE OF I/O ROUTINES
*  FOR THE 6850 USART.
*
* IF ROM ROUTINES ARE PRESENT, THEIR ADDRESSES MAY SIMPLY BE 
*  FILLED IN IN THE USER TABLE!
*
PORTAD	EQU	$010040
*
XEMIT	MOVE.L	#PORTAD,A0
XEMIT1	BTST	#1,(A0)
	BEQ.S	XEMIT1
	MOVE.B	D0,2(A0)
	RTS      
*
XKEY	MOVE.L	#PORTAD,A0
XKEY1	BTST	#0,(A0)
	BEQ.S	XKEY1
	MOVE.B	2(A0),D0
	AND.W	#$7F,D0
	RTS      
*
XCR	MOVEQ	#ACR,D0
	JSR	XEMIT
	MOVEQ	#LF,D0
	JSR	XEMIT
	RTS
*
XQTERM	MOVE.L	#PORTAD,A0
	MOVE.B	(A0),D0
	AND.W	#1,D0
	RTS      
*
XRSLW	RTS
*
*---------------------------------------------------
*
	ORG	$2000
DP0			*START OF FORTH DICTIONARY
	DC.B	$83	* LIT
	DC.B	'LI'
	DC.B	$80+'T'
	DC.W	0	* (LFA)=0 MARKS END OF DICTIONARY
LIT	DC.W	2+*	* (S1) <- ((IP))
	MOVE.W	(A4)+,-(A3)
	MOVE.W	(A4)+,A5
	MOVE.W	(A5)+,A0
	JMP	(A0)
*
	DC.B	$87	* EXECUTE
	DC.B	'EXECUT'
	DC.B	$80+'E'
	DC.W	LIT-6
EXEC	DC.W	2+*
	MOVE.W	(A3)+,A5
	MOVE.W	(A5)+,A0
	JMP	(A0)
*
	DC.B	0,$86	* BRANCH
	DC.B	'BRANC'
	DC.B	$80+'H'
	DC.W	EXEC-$0A
BRAN	DC.W	2+*	* (IP) <- (IP) + ((IP))
	MOVE.W	(A4),D0
	ADD.W	D0,A4
	MOVE.W	(A4)+,A5
	MOVE.W	(A5)+,A0
	JMP	(A0)
*
	DC.B	$87	* 0BRANCH
	DC.B	'0BRANC'
	DC.B	$80+'H'
	DC.W	BRAN-$09
ZBRAN	DC.W	2+*
	TST.W  	(A3)+
	BEQ.S	BRAN+2	
	ADDQ.W	#2,A4
	MOVE.W	(A4)+,A5
	MOVE.W	(A5)+,A0
	JMP	(A0)
*
	DC.B	0,$86	* (LOOP)
	DC.B	'(LOOP'
	DC.B	$80+')'
	DC.W	ZBRAN-$0A
XLOOP	DC.W	2+*
	ADD.W	#1,(A7)	* Increment current count
XLOO2	MOVE.W	2(A7),D0	* Limit = current?
	CMP.W	(A7),D0	* Is better way?
	BHI.S	XLOO3	* Branch if limit>current
	ADD.W	#2,A4	* Clean up and leave
	ADD.W	#4,A7
	BRA.S	XLOO4
XLOO3	MOVE.W	(A4),D0
	ADD.W	D0,A4
XLOO4	
	MOVE.W	(A4)+,A5
	MOVE.W	(A5)+,A0
	JMP	(A0)
*
	DC.B	$87	* (+LOOP)
	DC.B	'(+LOOP'
	DC.B	$80+')'
	DC.W	XLOOP-$09
XPLOO	DC.W	2+*
	MOVE.W	(A3)+,D0
	ADD.W	D0,(A7)
	BRA.S	XLOO2	
*
	DC.B	0,$84	* (DO)
	DC.B	'(DO'
	DC.B	$80+')'
	DC.W	XPLOO-$0A
XDO	DC.W	2+*
	MOVE.L	(A3)+,-(A7)
	MOVE.W	(A4)+,A5
	MOVE.W	(A5)+,A0
	JMP	(A0)
*
*F	DC.B	$81	* I
*F	DC.B	$80+'I'
*F	DC.W	XDO-8
*F IDO	DC.W	2+*	* (S1) <- (R1), (R1) UNCHANGED
*F
	DC.B	$85	* DIGIT
	DC.B	'DIGI'
	DC.B	$80+'T'
	DC.W	XDO-7
DIGIT	DC.W	2+*
	MOVE.W	(A3)+,D1	* Load base into D1
	MOVE.W	(A3),D0	* Load ASCII into D2
	SUB.W	#$30,D0	* '0'
	BCS.S	BADDIG
	CMP.W	#9,D0
	BLE.S	BASECK
	CMP.W	#17,D0
	BLT.S	BADDIG
*	SUB.W	#$07,D0
	DC.W	$0440		* TO FORCE NON QUICK SUB
	DC.W	$0007 		*   FOLLOWING MANTEI CLOSELY 
BASECK	CMP.W	D1,D0
	BGE.S	BADDIG
	MOVE.W	D0,(A3)	* Return binary on stack
	MOVE.W	#1,-(A3)	* & gooddigit flag
	BRA.S	DIGIT1
BADDIG	MOVE.W	#0,(A3)
DIGIT1	MOVE.W	(A4)+,A5
	MOVE.W	(A5)+,A0
	JMP	(A0)
*
	DC.B	0,$86	* (FIND)  (2-1)FAILURE
	DC.B	'(FIND'
	DC.B	$80+')'
	DC.W	DIGIT-8
PFIND	DC.W	2+*
	MOVEQ	#1,D0	* Shift count
	MOVEQ	#7,D5	* Bit pointer
	MOVE.W	(A3)+,A1	* Load trial NFA
	MOVE.W	(A3),A0	* Fixed test ptr
PFIN1	MOVE.W	A0,A2	* Make work copy test ptr
	MOVE.B	(A1)+,D1	* Read NFA lengthbyte
	MOVE.B	D1,D4 	* Make copy of NFA length
	MOVE.W	D4,D3 	* Make another copy
	AND.W	#31,D3 	* Mask to get count
	ADD.W	A1,D3 	* Add count to NFA+1
	ADD.W	#1,D3 	*  and find next even..	
	AND.W	#$FFFE,D3 	* Address is LFA
	MOVE.B	(A2)+,D6
	EOR.B	D6,D4		* Compare length bytes
	AND.B	#63,D4 	* 6 lowest bits
	BNE.S	PFIN3 	* Branch if lengths differ
PFIN2  	MOVE.B	(A2)+,D2	* Get ASCII text char
	BCLR	D5,D2 	* Ignore bit 7...
	MOVE.B	(A1)+,D6
	EOR.B	D6,D2 	* Compare NFA char
	ASL.B	D0,D2 	* Shift out bit 7 ...
	BNE.S	PFIN3 	* And branch if no match
	BCC.S	PFIN2 	* or loop till last char
	ADD.W	#4,D3 	* Calculate PFA of found word
	MOVE.W	D3,(A3) 	* & leave on stack
	AND.W	#255,D1
	MOVE.W	D1,-(A3)	* Leave lengthbyte on stack
	MOVE.W	#1,-(A3)	* Leave found NFA flag
	BRA.S	PFIN4
PFIN3	MOVE.W	D3,A2 	* Put LFA into address reg
	MOVE.W	(A2),A1 	* Load linked PFA
	MOVE.W	A1,D6 	* So can see if zeros
	BNE.S	PFIN1 	*  till exhaust dictionary
	MOVE.W	#0,(A3) 	* Leave fail flag
PFIN4	MOVE.W	(A4)+,A5
	MOVE.W	(A5)+,A0
	JMP	(A0)
*
	DC.B	$87 	* ENCLOSE
	DC.B	'ENCLOS'
	DC.B	$80+'E'
	DC.W	PFIND-9
ENCL	DC.W	2+*
	MOVE.W	(A3)+,D0 	* Delimiter
	MOVE.W	(A3),A0 	* Text address
	CLR.L	D1
	BRA.S	ENCL2
ENCL1	ADD.W 	#1,D1
ENCL2	CMP.B	0(A0,D1.W),D0
	BEQ.S	ENCL1 	* Loop till nondelimit
	MOVE.W	D1,-(A3) 	* Save N1
ENCL3	CMP.B	0(A0,D1.W),D0
	BEQ.S	ENCL6
	CMP.B	#0,0(A0,D1.W)
	BEQ.S	ENCL4 	* ASCII 00
	ADD.W	#1,D1
	BRA.S	ENCL3
ENCL4	CMP.W	(A3),D1 	* Just 00 ?
	BNE.S	ENCL5 	* Branch if not
	ADD.W	#1,D1 	* Enclose 00
	MOVE.W	D1,-(A3) 	* Save N2
	BRA.S	ENCL8
ENCL5	MOVE.W	D1,-(A3) 	* Save N2
	BRA.S	ENCL8
ENCL6	MOVE.W	D1,-(A3) 	* Save N2
	ADD.W	#1,D1 	* Skip delimiter
ENCL8	MOVE.W	D1,-(A3) 	* Save N3
	MOVE.W	(A4)+,A5
	MOVE.W	(A5)+,A0
	JMP	(A0)
*
* REMARK :
*  The first 2 instructions don't serve their intended
*  purpose of clearing the m.s. 16 bits of A1 and A2.
*  This, by the way, would make CMOVE incompatible with
*  the other stores and fetches of this FORTH
*  (that is effectively a 32K address range forth)
*  This CMOVE is intelligent.
*  To arrive at a non-intelligent CMOVE as required by the 
*  FIG FORTH glossary leave out all the instructions marked 
*  with *D
*				(AH&AK)
*
	DC.B	$85 	* CMOVE
	DC.B	'CMOV'
	DC.B	$80+'E' 	* INTELLIGENT CMOVE!!
	DC.W	ENCL-$0A
CMOVE	DC.W	2+*
	MOVE.L	#0,A0	*D
	MOVE.L	A0,A1	*D
	MOVE.W	(A3)+,D0
	MOVE.W	(A3)+,A1
	MOVE.W	(A3)+,A0
	CMP.W	A0,A1	*D
	BGT.S	MOVBK	*D
	BRA.S	MOVFW1
MOVFWD	MOVE.B	(A0)+,(A1)+
MOVFW1	DBF	D0,MOVFWD
	BRA.S	CMOVE5	*D
MOVBK	ADD.W	D0,A0	*D
	ADD.W	D0,A1	*D
	BRA.S	MOVBK2	*D
MOVBK1	MOVE.B	-(A0),-(A1)	*D
MOVBK2	DBF	D0,MOVBK1	*D
CMOVE5	MOVE.W	(A4)+,A5
	MOVE.W	(A5)+,A0
	JMP	(A0)
*
	DC.B	0,$82	* U* 16 * 16 UNSIGNED MULTIPLY
	DC.B	'U'
	DC.B	$80+'*'
	DC.W	CMOVE-8
USTAR	DC.W	2+*
	MOVE.W	(A3)+,D0
	MULU	(A3)+,D0
	MOVE.L	D0,-(A3)
	MOVE.W	(A4)+,A5
	MOVE.W	(A5)+,A0
	JMP	(A0)
*
	DC.B	0,$82	* U/
	DC.B	'U'
	DC.B	$80+'/'
	DC.W	USTAR-5
USLAS	DC.W	2+*
	MOVE.W	(A3)+,D1 
	MOVE.L	(A3),D0
	DIVU	D1,D0
	SWAP	D0
	MOVE.L	D0,(A3)
	MOVE.W	(A4)+,A5
	MOVE.W	(A5)+,A0
	JMP	(A0)
*
	DC.B	$83	* AND
	DC.B	'AN'
	DC.B	$80+'D'
	DC.W	USLAS-5
ANDD	DC.W	2+*	* (S1) <- (S1) AND (S2)
	MOVE.W	(A3)+,D0
	AND.W	D0,(A3)
	MOVE.W	(A4)+,A5
	MOVE.W	(A5)+,A0
	JMP	(A0)
	DC.B	0,$82	* OR
	DC.B	'O'
	DC.B	$80+'R'
	DC.W	ANDD-6
ORR	DC.W	2+*	* (S1) <- (S1) OR (S2)
	MOVE.W	(A3)+,D0
	OR.W	D0,(A3)
	MOVE.W	(A4)+,A5
	MOVE.W	(A5)+,A0
	JMP	(A0)
	DC.B	$83	* XOR
	DC.B	'XO'
	DC.B	$80+'R'
	DC.W	ORR-5
XORR	DC.W	2+*	* (S1) <- (S1) XOR (S2)
	MOVE.W	(A3)+,D0
	EOR.W	D0,(A3)
	MOVE.W	(A4)+,A5
	MOVE.W	(A5)+,A0
	JMP	(A0)
	DC.B	$83	* SP@
	DC.B	'SP'
	DC.B	$80+'@'
	DC.W	XORR-6
SPAT	DC.W	2+*	* (S1) <- (SP)
	MOVE.W	A3,D0
	MOVE.W	D0,-(A3)
	MOVE.W	(A4)+,A5
	MOVE.W	(A5)+,A0
	JMP	(A0)
	DC.B	$83	* SP!
	DC.B	'SP'
	DC.B	$80+'!'
	DC.W	SPAT-6
SPSTO	DC.W	2+*	* (SP) <- (S0) ( USER VARIABLE )
	MOVE.W	6(A6),A3
	MOVE.W	(A4)+,A5
	MOVE.W	(A5)+,A0
	JMP	(A0)
*F
*F	DC.B	$83	* RP@
*F	DC.B	'RP'
*F	DC.B	$80+'@'
*F	DC.W	SPSTO-6
*F RPAT	DC.W	2+*	* (S1) <- (RP)
*F < CODE OF RP@ >
*F NEXT
	DC.B	$83	* RETURN STACK POINTER STORE
	DC.B	'RP'
	DC.B	$80+'!'
	DC.W	SPSTO-6
RPSTO	DC.W	2+*	* (RP) <- (R0) ( USER VARIABLE )
	MOVE.W	8(A6),A7
	MOVE.W	(A4)+,A5
	MOVE.W	(A5)+,A0
	JMP	(A0)
	DC.B	0,$82	* ;
	DC.B	';'
	DC.B	$80+'S'
	DC.W	RPSTO-6
SEMIS	DC.W	2+*	* (IP) <- (R1)
	MOVE.W	(A7)+,A4
	MOVE.W	(A4)+,A5
	MOVE.W	(A5)+,A0
	JMP	(A0)
	DC.B	$85	* LEAVE
	DC.B	'LEAV'
	DC.B	$80+'E'
	DC.W	SEMIS-5
LEAVE	DC.W	2+*	* LIMIT <- INDEX
	MOVE.W	(A7),2(A7)
	MOVE.W	(A4)+,A5
	MOVE.W	(A5)+,A0
	JMP	(A0)
	DC.B	0,$82	* >R
	DC.B	'>'
	DC.B	$80+'R'
	DC.W	LEAVE-8
TOR	DC.W	2+*	* (R1) <- (S1)
	DC.W	$3F1B
	MOVE.W	(A4)+,A5
	MOVE.W	(A5)+,A0
	JMP	(A0)
	DC.B	0,$82	* R>
	DC.B	'R'
	DC.B	$80+'>'
	DC.W	TOR-5
FROMR	DC.W	2+*
	MOVE.W	(A7)+,-(A3)
	MOVE.W	(A4)+,A5
	MOVE.W	(A5)+,A0
	JMP	(A0)
	DC.B	$81	* R
	DC.B	$80+'R'
	DC.W	FROMR-5
RR	DC.W	2+*
	MOVE.W	(A7),-(A3)
	MOVE.W	(A4)+,A5
	MOVE.W	(A5)+,A0
	JMP	(A0)
	DC.B	0,$82	* 0=
	DC.B	'0'
	DC.B	$80+'='
	DC.W	RR-4
ZEQU	DC.W	2+*
	TST.W	(A3)
	SEQ     1(A3)
	AND.W	#1,(A3)
	MOVE.W	(A4)+,A5
	MOVE.W	(A5)+,A0
	JMP	(A0)
	DC.B	0,$82	* 0<
	DC.B	'0'
	DC.B	$80+'<'
	DC.W	ZEQU-5
ZLESS	DC.W	2+*
	TST.W	(A3)
	SMI	1(A3)
	AND.W	#1,(A3)
	MOVE.W	(A4)+,A5
	MOVE.W	(A5)+,A0
	JMP	(A0)
	DC.B	$81	* +
	DC.B	$80+'+'
	DC.W	ZLESS-5
PLUS	DC.W	2+*	* (S1) <- (S1) + (S2)
	MOVE.W	(A3)+,D0
	ADD.W	D0,(A3)
	MOVE.W	(A4)+,A5
	MOVE.W	(A5)+,A0
	JMP	(A0)
*
	DC.B	$85	* MINUS
	DC.B	'MINU'
	DC.B	$80+'S'
	DC.W	PLUS-4
MINUS	DC.W	2+*	* (S1) <- -(S1) ( 2'S COMPLEMENT )
	NEG.W	(A3)
	MOVE.W	(A4)+,A5
	MOVE.W	(A5)+,A0
	JMP	(A0)
*
	DC.B	0,$82	* D+ (4-2)
	DC.B	'D'	* XLW XHW  YLW YHW --- SLW SHW
	DC.B	$80+'+'	* S4  S3   S2  S1      S2  S1
	DC.W	MINUS-8
DPLUS	DC.W	2+*
	MOVE.L	(A3)+,D0
	ADD.L	D0,(A3)
	MOVE.W	(A4)+,A5
	MOVE.W	(A5)+,A0
	JMP	(A0)
	DC.B	0,$86	* DMINUS
	DC.B	'DMINU'
	DC.B	$80+'S'
	DC.W	DPLUS-5
DMINU	DC.W	2+*
	NEG.L	(A3)
	MOVE.W	(A4)+,A5
	MOVE.W	(A5)+,A0
	JMP	(A0)
	DC.B	0,$84	* OVER
	DC.B	'OVE'
	DC.B	$80+'R'
	DC.W	DMINU-$09
OVER	DC.W	2+*
	MOVE.W	2(A3),D0
	MOVE.W	D0,-(A3)
	MOVE.W	(A4)+,A5
	MOVE.W	(A5)+,A0
	JMP	(A0)
	DC.B	0,$84	* DROP
	DC.B	'DRO'
	DC.B	$80+'P'
	DC.W	OVER-7
DROP	DC.W	2+*
	ADDQ.W	#2,A3
	MOVE.W	(A4)+,A5
	MOVE.W	(A5)+,A0
	JMP	(A0)
	DC.B	0,$84	* SWAP
	DC.B	'SWA'
	DC.B	$80+'P'
	DC.W	DROP-7
SWAP	DC.W	2+*
	MOVE.W	(A3)+,D0
	MOVE.W	(A3),D1
	MOVE.W	D0,(A3)
	MOVE.W	D1,-(A3)
	MOVE.W	(A4)+,A5
	MOVE.W	(A5)+,A0
	JMP	(A0)
	DC.B	$83	* DUP
	DC.B	'DU'
	DC.B	$80+'P'
	DC.W	SWAP-7
DUP	DC.W	2+*
	MOVE.W	(A3),D0
	MOVE.W	D0,-(A3)
	MOVE.W	(A4)+,A5
	MOVE.W	(A5)+,A0
	JMP	(A0)
*F
*F	DC.B	0,$84	* 2DUP
*F	DC.W	DUP-6
*F	DC.B	'2DU'
*F	DC.B	$80+'P'
*F TDUP	DC.W	2+*
	DC.B	0,$82	* PLUS STORE
	DC.B	'+'
	DC.B	$80+'!'
	DC.W	DUP-6
PSTOR	DC.W	2+*	* ((S1)) <- ((S1)) + (S2)
	MOVE.W	(A3)+,A0
	MOVE.W	(A3)+,D0
	ADD.W	D0,(A0)
	MOVE.W	(A4)+,A5
	MOVE.W	(A5)+,A0
	JMP	(A0)
	DC.B	0,$86	* TOGGLE
	DC.B	'TOGGL'
	DC.B	$80+'E'
	DC.W	PSTOR-5
TOGGL	DC.W	2+*	* ((S2)) <- ((S2)) XOR (S1)LB
	MOVE.W	(A3)+,D0
	MOVE.W	(A3)+,A0
	EOR.B	D0,(A0)
	MOVE.W	(A4)+,A5
	MOVE.W	(A5)+,A0
	JMP	(A0)
*
	DC.B	$81	* @
	DC.B	$80+'@'
	DC.W	TOGGL-$09
AT	DC.W	2+*	* (S1) <- ((S1))
	MOVE.W	(A3),A0
	MOVE.W	(A0),(A3)
	MOVE.W	(A4)+,A5
	MOVE.W	(A5)+,A0
	JMP	(A0)
*
	DC.B	0,$82	* C@
	DC.B	'C'
	DC.B	$80+'@'
	DC.W	AT-4
CAT	DC.W	2+*	* (S1) <- ((S1))LB
	MOVE.W	(A3)+,A0
	MOVE.B	(A0),-(A3)
	MOVE.B	#0,-(A3)
	MOVE.W	(A4)+,A5
	MOVE.W	(A5)+,A0
	JMP	(A0)
*
*F	DC.B	0,$82	* 2@
*F	DC.B	'2'
*F	DC.B	$80+'@'
*F	DC.W	<PREC-LENP>
*F TAT	DC.W	2+*
*F
	DC.B	$81	* STORE
	DC.B	$80+'!'
	DC.W	CAT-5
STORE	DC.W	2+*	* ((S1)) <- (S2)
	MOVE.W	(A3)+,A0
	MOVE.B	(A3)+,(A0)+
	MOVE.B	(A3)+,(A0)
	MOVE.W	(A4)+,A5
	MOVE.W	(A5)+,A0
	JMP	(A0)
*
	DC.B	0,$84	* FILL
	DC.B	'FIL'
	DC.B	$80+'L'
	DC.W	STORE-4
FILL	DC.W	2+*
	MOVE.W	(A3)+,D0
	MOVE.W	(A3)+,D1
	MOVE.W	(A3)+,A0
	BRA.S	FILL3
FILL2	MOVE.B	D0,(A0)+
FILL3	DBF	D1,FILL2
	MOVE.W	(A4)+,A5
	MOVE.W	(A5)+,A0
	JMP	(A0)
*
	DC.B	0,$82	* C STORE
	DC.B	'C'
	DC.B	$80+'!'
	DC.W	FILL-7
CSTOR	DC.W	2+*	* ((S1))LB <- (S2)LB
	MOVE.W	(A3)+,A0
	ADD.W	#1,A3	*	DC.W	$524B
	MOVE.B	(A3)+,(A0)	*	DC.W	$109B
	MOVE.W	(A4)+,A5
	MOVE.W	(A5)+,A0
	JMP	(A0)
*F
*F	DC.B	0,$82	* 2 STORE
*F	DC.B	'2'
*F	DC.B	$80+'!'
*F	DC.W	CSTOR-6
*F TSTOR	DC.W	2+*
*F
	DC.B	0,$82	* C=
	DC.B	'C'
	DC.B	$80+'='
	DC.W	CSTOR-5
CEQU	DC.W	DOCOL
	DC.W	SUBB
	DC.W	LIT,$00FF
	DC.W	ANDD
	DC.W	ZEQU
	DC.W	SEMIS
*
	DC.B	0,$84	* S->D
	DC.B	'S->'
	DC.B	$80+'D'
	DC.W	CEQU-5
STOD	DC.W	2+*	*
	TST.W	(A3)
	BMI.S	STOD1
	MOVE.W	#0,-(A3)
	BRA.S	STOD2
STOD1	MOVE.W	#$FFFF,-(A3)
STOD2	MOVE.W	(A4)+,A5
	MOVE.W	(A5)+,A0
	JMP	(A0)
*
	DC.B	0,$84	* EMIT
	DC.B	'EMI'
	DC.B	$80+'T'
	DC.W	STOD-7
EMIT	DC.W	2+*	*
	MOVE.W	(A3)+,D0
	ADD.W	#1,26(A6)
	MOVE.W	64(A6),A0
	JSR	(A0)
	MOVE.W	(A4)+,A5
	MOVE.W	(A5)+,A0
	JMP	(A0)
*
	DC.B	$83	* KEY
	DC.B	'KE'
	DC.B	$80+'Y'
	DC.W	EMIT-7
KEY	DC.W	2+*	*
	MOVE.W	$42(A6),A0
	JSR	(A0)
	MOVE.W	D0,-(A3)
	MOVE.W	(A4)+,A5
	MOVE.W	(A5)+,A0
	JMP	(A0)
*
	DC.B	$89	* ?TERMINAL
	DC.B	'?TERMINA'
	DC.B	$80+'L'
	DC.W	KEY-6
QTERM	DC.W	2+*	*
	MOVE.W	$44(A6),A0
	JSR	(A0)
	MOVE.W	D0,-(A3)
	MOVE.W	(A4)+,A5
	MOVE.W	(A5)+,A0
	JMP	(A0)
*
	DC.B	0,$82	* CR
	DC.B	'C'
	DC.B	$80+'R'
	DC.W	QTERM-$0C
CR	DC.W	2+*	*
	MOVE.W	#0,26(A6)
	MOVE.W	70(A6),A0
	JSR	(A0)
	MOVE.W	(A4)+,A5
	MOVE.W	(A5)+,A0
	JMP	(A0)
*
	DC.B	$85	* (VAR)
	DC.B	'(VAR'
	DC.B	$80+')'
	DC.W	CR-5
	DC.W	2+*	*
DOVAR	MOVE.W	A5,-(A3)
	MOVE.W	(A4)+,A5
	MOVE.W	(A5)+,A0
	JMP	(A0)
*
	DC.B	$87	*(CONST)
	DC.B	'(CONST'
	DC.B	$80+')'
	DC.W	DOVAR-$0A
	DC.W	2+*	*
DOCON	MOVE.W	(A5),-(A3) *	DC.W	$3715
	MOVE.W	(A4)+,A5
	MOVE.W	(A5)+,A0
	JMP	(A0)
*
	DC.B	0,$86	* (USER)
	DC.B	'(USER'
	DC.B	$80+')'
	DC.W	DOCON-$0C
	DC.W	2+*	*
DOUSE	MOVE.W	(A5),D0
	ADD.W	A6,D0
	MOVE.W	D0,-(A3)
	MOVE.W	(A4)+,A5
	MOVE.W	(A5)+,A0
	JMP	(A0)
*
	DC.B	0,$8E	* (USERCONSTANT)
	DC.B	'(USERCONSTANT'
	DC.B	$80+')'
	DC.W	DOUSE-$0B
	DC.W	2+*	*
DOUSC	MOVE.W	(A5),A0
	ADD.W	A6,A0
	MOVE.W	(A0),-(A3)
	MOVE.W	(A4)+,A5
	MOVE.W	(A5)+,A0
	JMP	(A0)
*
	DC.B	0,$86	* (NEST)
	DC.B	'(NEST'
	DC.B	$80+')'
	DC.W	DOUSC-$13
	DC.W	2+*	*
DOCOL	MOVE.W	A4,-(A7)
	MOVE.W	A5,A4
	MOVE.W	(A4)+,A5
	MOVE.W	(A5)+,A0
	JMP	(A0)
*  PAGE
*
* CONSTANTS,USER VARIABLES &
* USER CONSTANTS
*
	DC.B	$81	* 0
	DC.B	$80+'0'
	DC.W	DOCOL-$0B
ZERO	DC.W	DOCON
	DC.W	0
*
	DC.B	$81	* 1
	DC.B	$80+'1'
	DC.W	ZERO-4
ONE	DC.W	DOCON
	DC.W	1
*
	DC.B	$81	* 2
	DC.B	$80+'2'
	DC.W	ONE-4
TWO	DC.W	DOCON
	DC.W	2
*
	DC.B	$81	* 3
	DC.B	$80+'3'
	DC.W	TWO-4
THREE	DC.W	DOCON
	DC.W	3
*
	DC.B	0,$82	* BL
	DC.B	'B'
	DC.B	$80+'L'
	DC.W	THREE-4
BL	DC.W	DOCON
	DC.B	0,' '
*
	DC.B	$87 	* BKSPKEY
	DC.B	'BKSPKE'
	DC.B	$80+'Y'
	DC.W	BL-5
BKSPK	DC.W	DOUSE
	DC.W	2
*
	DC.B	0,$82 	* S0
	DC.B	'S'
	DC.B	$80+'0'
	DC.W	BKSPK-$0A
SZERO	DC.W	DOUSE
	DC.W	6
*
	DC.B	0,$82	* R0
	DC.B	'R'
	DC.B	$80+'0'
	DC.W	SZERO-5
RZERO	DC.W	DOUSE
	DC.W	8
*
	DC.B	$83	* TIB
	DC.B	'TI'
	DC.B	$80+'B'
	DC.W	RZERO-5
TIB	DC.W	DOUSE
	DC.B	0,$0A
*
	DC.B	$85	* WIDTH
	DC.B	'WIDT'
	DC.B	$80+'H'
	DC.W	TIB-6
WIDTH	DC.W	DOUSE
	DC.B	0,$0C
*
	DC.B	$87	* WARNING
	DC.B	'WARNIN'
	DC.B	$80+'G'
	DC.W	WIDTH-8
WARN	DC.W	DOUSE
	DC.B	0,$0E
*
	DC.B	$85	* FENCE
	DC.B	'FENC'
	DC.B	$80+'E'
	DC.W	WARN-$0A
FENCE	DC.W	DOUSE
	DC.B	0,$10
*
	DC.B	0,$82	* DP
	DC.B	'D'
	DC.B	$80+'P'
	DC.W	FENCE-8
DP	DC.W	DOUSE
	DC.B	0,$12
*
	DC.B	0,$88	* VOC-LINK
	DC.B	'VOC-LIN'
	DC.B	$80+'K'
	DC.W	DP-5
VOCL	DC.W	DOUSE
	DC.B	0,$14
*
	DC.B	$83	* BLK
	DC.B	'BL'
	DC.B	$80+'K'
	DC.W	VOCL-$0B
BLK	DC.W	DOUSE
	DC.B	0,$16
*
	DC.B	0,$82	* IN
	DC.B	'I'
	DC.B	$80+'N'
	DC.W	BLK-6
INN	DC.W	DOUSE
	DC.B	0,$18
*
	DC.B	$83	* OUT
	DC.B	'OU'
	DC.B	$80+'T'
	DC.W	INN-5
OUTT	DC.W	DOUSE
	DC.B	0,$1A
*
	DC.B	$83	* SCR
	DC.B	'SC'
	DC.B	$80+'R'
	DC.W	OUTT-6
SCR	DC.W	DOUSE
	DC.B	0,$1C
*
	DC.B	0,$86	* OFFSET
	DC.B	'OFFSE'
	DC.B	$80+'T'
	DC.W	SCR-6
OFSET	DC.W	DOUSE
	DC.B	0,$1E
*
	DC.B	$87	* CONTEXT
	DC.B	'CONTEX'
	DC.B	$80+'T'
	DC.W	OFSET-$09
CONT	DC.W	DOUSE
	DC.B	0,$20
*
	DC.B	$87	* CURRENT
	DC.B	'CURREN'
	DC.B	$80+'T'
	DC.W	CONT-$0A
CURR	DC.W	DOUSE
	DC.B	0,$22
*
	DC.B	$85	* STATE
	DC.B	'STAT'
	DC.B	$80+'E'
	DC.W	CURR-$0A
STATE	DC.W	DOUSE
	DC.B	0,$24
*
	DC.B	0,$84	* BASE
	DC.B	'BAS'
	DC.B	$80+'E'
	DC.W	STATE-8
BASE	DC.W	DOUSE
	DC.B	0,$26
*
	DC.B	$83	* DPL
	DC.B	'DP'
	DC.B	$80+'L'
	DC.W	BASE-7
DPL	DC.W	DOUSE
	DC.B	0,$28
*
	DC.B	$83	* FLD
	DC.B	'FL'
	DC.B	$80+'D'
	DC.W	DPL-6
FLD	DC.W	DOUSE
	DC.B	0,$2A
*
	DC.B	$83	* CSP
	DC.B	'CS'
	DC.B	$80+'P'
	DC.W	FLD-6
CSPP	DC.W	DOUSE
	DC.B	0,$2C
*
	DC.B	0,$82	* R#
	DC.B	'R'
	DC.B	$80+'#'
	DC.W	CSPP-6
RNUM	DC.W	DOUSE
	DC.B	0,$2E
*
	DC.B	$83	* HLD
	DC.B	'HL'
	DC.B	$80+'D'
	DC.W	RNUM-5
HLD	DC.W	DOUSE
	DC.B	0,$30
*
	DC.B	$85	* FIRST
	DC.B	'FIRS'
	DC.B	$80+'T'
	DC.W	HLD-6
FIRST	DC.W	DOUSC
	DC.B	0,$34
*
	DC.B	$85	* LIMIT
	DC.B	'LIMI'
	DC.B	$80+'T'
	DC.W	FIRST-8
LIMIT	DC.W	DOUSC
	DC.B	0,$36
*
	DC.B	$83	* USE
	DC.B	'US'
	DC.B	$80+'E'
	DC.W	LIMIT-8
USE	DC.W	DOUSE
	DC.B	0,$38
*
	DC.B	0,$84	* PREV
	DC.B	'PRE'
	DC.B	$80+'V'
	DC.W	USE-6
PREV	DC.W	DOUSE
	DC.B	0,$3A
*
	DC.B	$89	* DICTLIMIT
	DC.B	'DICTLIMI'
	DC.B	$80+'T'
	DC.W	PREV-7
DICTL	DC.W	DOUSE
	DC.B	0,$3C
*
	DC.B	0,$88	* BKSPEMIT
	DC.B	'BKSPEMI'
	DC.B	$80+'T'
	DC.W	DICTL-$0C
BKSPE	DC.W	DOUSE
	DC.B	0,$3E
*
	DC.B	$87	* EMITSUB
	DC.B	'EMITSU'
	DC.B	$80+'B'
	DC.W	BKSPE-$0B
EMITS	DC.W	DOUSE
	DC.B	0,$40
*
	DC.B	0,$86	* KEYSUB
	DC.B	'KEYSU'
	DC.B	$80+'B'
	DC.W	EMITS-$0A
KEYSUB	DC.W	DOUSE
	DC.B	0,$42
*
	DC.B	0,$88	* QTERMSUB
	DC.B	'?TERMSU'
	DC.B	$80+'B'
	DC.W	KEYSUB-$09
QTERMS	DC.W	DOUSE
	DC.B	0,$44
*
	DC.B	$85	* CRSUB
	DC.B	'CRSU'
	DC.B	$80+'B'
	DC.W	QTERMS-$0B
CRSUB	DC.W	DOUSE
	DC.B	0,$46
*
	DC.B	0,$86	* R/WSUB
	DC.B	'R/WSU'
	DC.B	$80+'B'
	DC.W	CRSUB-8
RSLWS	DC.W	DOUSE
	DC.B	0,$48
*
	DC.B	$85	* B/BUF ( BYTES/BUFFER )
	DC.B	'B/BU'
	DC.B	$80+'F'
	DC.W	RSLWS-$09
BBUF	DC.W	DOUSC
	DC.B	0,$4A
*
	DC.B	$85	* B/SCR ( BUFFERS/SCREEN )
	DC.B	'B/SC'
	DC.B	$80+'R'
	DC.W	BBUF-8
BSCR	DC.W	DOUSC
	DC.B	0,$4C
*
	DC.B	$83	* C/L ( CHARACTERS/LINE )
	DC.B	'C/'
	DC.B	$80+'L'
	DC.W	BSCR-8
CSLL	DC.W	DOUSC
	DC.B	0,$4E
*
* END OF VARIABLES & CONSTANTS
*
	DC.B	0,$82	* 1+
	DC.B	'1'
	DC.B	$80+'+'
	DC.W	CSLL-6
ONEP	DC.W	DOCOL
	DC.W	ONE
	DC.W	PLUS
	DC.W	SEMIS
*
	DC.B	0,$82	* 2+
	DC.B	'2'
	DC.B	$80+'+'
	DC.W	ONEP-5
TWOP	DC.W	DOCOL
	DC.W	TWO
	DC.W	PLUS
	DC.W	SEMIS
*
	DC.B	0,$84	* HERE
	DC.B	'HER'
	DC.B	$80+'E'
	DC.W	TWOP-5
HERE	DC.W	DOCOL
	DC.W	DP
	DC.W	AT
	DC.W	SEMIS
*
	DC.B	$85	* ALLOT
	DC.B	'ALLO'
	DC.B	$80+'T'
	DC.W	HERE-7
ALLOT	DC.W	DOCOL
	DC.W	DP
	DC.W	PSTOR
	DC.W	SEMIS
*
	DC.B	$81	* ,
	DC.B	$80+','
	DC.W	ALLOT-8
COMMA	DC.W	DOCOL
	DC.W	HERE
	DC.W	STORE
	DC.W	TWO
	DC.W	ALLOT
	DC.W	SEMIS
*
	DC.B	0,$82	* C,
	DC.B	'C'
	DC.B	$80+','
	DC.W	COMMA-4
CCOMM	DC.W	DOCOL
	DC.W	HERE
	DC.W	CSTOR
	DC.W	ONE
	DC.W	ALLOT
	DC.W	SEMIS
*
	DC.B	$81	* -
	DC.B	$80+'-'
	DC.W	CCOMM-5
SUBB	DC.W	DOCOL
	DC.W	MINUS
	DC.W	PLUS
	DC.W	SEMIS
*
	DC.B	$81	* =
	DC.B	$80+'='
	DC.W	SUBB-4
EQUAL	DC.W	DOCOL
	DC.W	SUBB
	DC.W	ZEQU
	DC.W	SEMIS
*
	DC.B	$81	* <
	DC.B	$80+'<'
	DC.W	EQUAL-4
LESS	DC.W	DOCOL
	DC.W	SUBB
	DC.W	ZLESS
	DC.W	SEMIS
*F
*F	DC.B	0,$82	* U< ( UNSIGNED < )
*F	DC.B	'U'
*F	DC.B	$80+'<'
*F	DC.W	LESS-4
*F ULESS	DC.W	DOCOL,TDUP
*F	DC.W	XORR,ZLESS
*F	DC.W	ZBRAN,ULES1-*	* IF
*F	DC.W	DROP,ZLESS
*F	DC.W	ZEQU
*F	DC.W	BRAN,ULES2-*
*F ULES1	DC.W	SUBB,ZLESS	* ELSE
*F ULES2	DC.W	SEMIS	* ENDIF
*F
*
	DC.B	$81	* >
	DC.B	$80+'>'
	DC.W	LESS-4
GREAT	DC.W	DOCOL
	DC.W	SWAP
	DC.W	LESS
	DC.W	SEMIS
*
	DC.B	$83	* ROT
	DC.B	'RO'
	DC.B	$80+'T'
	DC.W	GREAT-4
ROT	DC.W	DOCOL
	DC.W	TOR
	DC.W	SWAP
	DC.W	FROMR
	DC.W	SWAP
	DC.W	SEMIS
*
	DC.B	$85	* SPACE
	DC.B	'SPAC'
	DC.B	$80+'E'
	DC.W	ROT-6
SPACE	DC.W	DOCOL
	DC.W	BL
	DC.W	EMIT
	DC.W	SEMIS
*
	DC.B	0,$84	* -DUP
	DC.B	'-DU'
	DC.B	$80+'P'
	DC.W	SPACE-8
DDUP	DC.W	DOCOL
	DC.W	DUP
	DC.W	ZBRAN	* IF
	DC.W	DDUP1-*
	DC.W	DUP	* ENDIF
DDUP1	DC.W	SEMIS
*
	DC.B	0,$88	* TRAVERSE
	DC.B	'TRAVERS'
	DC.B	$80+'E'
	DC.W	DDUP-7
TRAV	DC.W	DOCOL
	DC.W	SWAP
REP SET *	* BEGIN 
	DC.W	OVER
	DC.W	PLUS
	DC.W	LIT
	DC.W	$7F
	DC.W	OVER
	DC.W	CAT
	DC.W	LESS
	DC.W	ZBRAN	* UNTIL
	DC.W	REP-* 
	DC.W	SWAP
	DC.W	DROP
	DC.W	SEMIS
*
	DC.B	0,$86	* LATEST
	DC.B	'LATES'
	DC.B	$80+'T'
	DC.W	TRAV-$0B
LATES	DC.W	DOCOL
	DC.W	CURR
	DC.W	AT
	DC.W	AT
	DC.W	SEMIS
*
	DC.B	$83	* LFA
	DC.B	'LF'
	DC.B	$80+'A'
	DC.W	LATES-$09
LFA	DC.W	DOCOL
	DC.W	LIT
	DC.W	4
	DC.W	SUBB
	DC.W	SEMIS
*
	DC.B	$83	* CFA
	DC.B	'CF'
	DC.B	$80+'A'
	DC.W	LFA-6
CFA	DC.W	DOCOL
	DC.W	TWO
	DC.W	SUBB
	DC.W	SEMIS
*
	DC.B	$83	* NFA
	DC.B	'NF'
	DC.B	$80+'A'
	DC.W	CFA-6
NFA	DC.W	DOCOL
	DC.W	LIT
	DC.W	5
	DC.W	SUBB
	DC.W	LIT
	DC.W	0-1
	DC.W	TRAV
	DC.W	SEMIS
*
	DC.B	$83	* PFA
	DC.B	'PF'
	DC.B	$80+'A'
	DC.W	NFA-6
PFA	DC.W	DOCOL
	DC.W	ONE
	DC.W	TRAV
	DC.W	LIT
	DC.W	5
	DC.W	PLUS
	DC.W	SEMIS
*
	DC.B	0,$84	* STORE CSP
	DC.B	'!CS'
	DC.B	$80+'P'
	DC.W	PFA-6
SCSP	DC.W	DOCOL
	DC.W	SPAT
	DC.W	CSPP
	DC.W	STORE
	DC.W	SEMIS
*
	DC.B	0,$86	* ?ERROR
	DC.B	'?ERRO'
	DC.B	$80+'R'
	DC.W	SCSP-7
QERR	DC.W	DOCOL
	DC.W	SWAP
	DC.W	ZBRAN	* IF
	DC.W	QERR1-*
	DC.W	ERROR
	DC.W	BRAN	* ELSE
	DC.W	QERR2-*
QERR1	DC.W	DROP	* ENDIF
QERR2	DC.W	SEMIS
*
	DC.B	$85	* ?COMP
	DC.B	'?COM'
	DC.B	$80+'P'
	DC.W	QERR-$09
QCOMP	DC.W	DOCOL
	DC.W	STATE
	DC.W	AT
	DC.W	ZEQU
	DC.W	LIT
	DC.W	$11
	DC.W	QERR
	DC.W	SEMIS
*
	DC.B	$85	* ?EXEC
	DC.B	'?EXE'
	DC.B	$80+'C'
	DC.W	QCOMP-8
QEXEC	DC.W	DOCOL
	DC.W	STATE
	DC.W	AT
	DC.W	LIT
	DC.W	$12
	DC.W	QERR
	DC.W	SEMIS
*
	DC.B	0,$86	* ?PAIRS
	DC.B	'?PAIR'
	DC.B	$80+'S'
	DC.W	QEXEC-8
QPAIR	DC.W	DOCOL
	DC.W	SUBB
	DC.W	LIT
	DC.W	$13
	DC.W	QERR
	DC.W	SEMIS
*
	DC.B	0,$84	* ?CSP
	DC.B	'?CS'
	DC.B	$80+'P'
	DC.W	QPAIR-$09
QCSP	DC.W	DOCOL
	DC.W	SPAT
	DC.W	CSPP
	DC.W	AT
	DC.W	SUBB
	DC.W	LIT
	DC.W	$14
	DC.W	QERR
	DC.W	SEMIS
*
	DC.B	0,$88	* ?LOADING
	DC.B	'?LOADIN'
	DC.B	$80+'G'
	DC.W	QCSP-7
QLOAD	DC.W	DOCOL
	DC.W	BLK
	DC.W	AT
	DC.W	ZEQU
	DC.W	LIT
	DC.W	$16
	DC.W	QERR
	DC.W	SEMIS
*
	DC.B	$87	* COMPILE
	DC.B	'COMPIL'
	DC.B	$80+'E'
	DC.W	QLOAD-$0B
COMP	DC.W	DOCOL
	DC.W	QCOMP
	DC.W	FROMR
	DC.W	DUP
	DC.W	TWOP
	DC.W	TOR
	DC.W	AT
	DC.W	COMMA
	DC.W	SEMIS
*
	DC.B	$C1	* [
	DC.B	$80+'['
	DC.W	COMP-$0A
LBRAC	DC.W	DOCOL
	DC.W	ZERO
	DC.W	STATE
	DC.W	STORE
	DC.W	SEMIS
*
	DC.B	$81	* ]
	DC.B	$80+']'
	DC.W	LBRAC-4
RBRAC	DC.W	DOCOL
	DC.W	LIT,$C0
	DC.W	STATE,STORE
	DC.W	SEMIS
*
	DC.B	0,$86	* SMUDGE
	DC.B	'SMUDG'
	DC.B	$80+'E'
	DC.W	RBRAC-4
SMUDG	DC.W	DOCOL
	DC.W	LATES
	DC.W	LIT
	DC.W	$20
	DC.W	TOGGL
	DC.W	SEMIS
*
	DC.B	$83	* HEX
	DC.B	'HE'
	DC.B	$80+'X'
	DC.W	SMUDG-$09
HEX	DC.W	DOCOL
	DC.W	LIT
	DC.W	$10
	DC.W	BASE
	DC.W	STORE
	DC.W	SEMIS
*
	DC.B	$87	* DECIMAL
	DC.B	'DECIMA'
	DC.B	$80+'L'
	DC.W	HEX-6
DEC	DC.W	DOCOL
	DC.W	LIT
	DC.W	$0A
	DC.W	BASE
	DC.W	STORE
	DC.W	SEMIS

*
	DC.B	$87	* (;CODE)
	DC.B	'(;CODE'
	DC.B	$80+')'
	DC.W	DEC-$0A
PSCOD	DC.W	DOCOL
	DC.W	FROMR
	DC.W	LATES
	DC.W	PFA
	DC.W	CFA
	DC.W	STORE
	DC.W	SEMIS
*F
*F	DC.B	$C5	*	*CODE
*F	DC.B	';COD'
*F	DC.B	$80+'E'
*F	DC.W	PSCOD-$0A
*F SEMIC	DC.W	DOCOL
*F	DC.W	QCSP
*F	DC.W	COMP
*F	DC.W	PSCOD
*F	DC.W	LBRAC
*F SEMI1	DC.W	NOOP	* ( ASSEMBLER )
*F	DC.W	SEMIS
*
	DC.B	$85	* COUNT
	DC.B	'COUN'
	DC.B	$80+'T'
	DC.W	PSCOD-$0A
COUNT	DC.W	DOCOL
	DC.W	DUP
	DC.W	ONEP
	DC.W	SWAP
	DC.W	CAT
	DC.W	SEMIS
*
	DC.B	0,$84	* TYPE
	DC.B	'TYP'
	DC.B	$80+'E'
	DC.W	COUNT-8
TYPE	DC.W	DOCOL
	DC.W	DDUP
	DC.W	ZBRAN	* IF
	DC.W	TYPE1-*
	DC.W	OVER
	DC.W	PLUS
	DC.W	SWAP
	DC.W	XDO	* DO
TYPE2	DC.W	RR	* MEANS IDO
	DC.W	CAT
	DC.W	EMIT
	DC.W	XLOOP	* LOOP
	DC.W	TYPE2-*
	DC.W	BRAN	* ELSE
	DC.W	TYPE3-*
TYPE1	DC.W	DROP	* ENDIF
TYPE3	DC.W	SEMIS
*
	DC.B	$89	* -TRAILING
	DC.B	'-TRAILIN'
	DC.B	$80+'G'
	DC.W	TYPE-7
DTRAI	DC.W	DOCOL
	DC.W	DUP
	DC.W	ZERO
	DC.W	XDO	* DO
DTRA1	DC.W	OVER
	DC.W	OVER
	DC.W	PLUS
	DC.W	ONE
	DC.W	SUBB
	DC.W	CAT
	DC.W	BL
	DC.W	SUBB
	DC.W	ZBRAN	* IF
	DC.W	DTRA2-*
	DC.W	LEAVE
	DC.W	BRAN	* ELSE
	DC.W	DTRA3-*
DTRA2	DC.W	ONE
	DC.W	SUBB	* ENDIF
DTRA3	DC.W	XLOOP	* LOOP
	DC.W	DTRA1-*
	DC.W	SEMIS
*
*
	DC.B	0,$84	* (.")
	DC.B	'(."'
	DC.B	$80+')'
	DC.W	DTRAI-$0C
PDOTQ	DC.W	DOCOL
	DC.W	RR
	DC.W	COUNT
	DC.W	DUP
	DC.W	TWOP
	DC.W	LIT,$FFFE
	DC.W	ANDD
	DC.W	FROMR
	DC.W	PLUS
	DC.W	TOR
	DC.W	TYPE
	DC.W	SEMIS
*
	DC.B	0,$86	* EXPECT
	DC.B	'EXPEC'
	DC.B	$80+'T'
	DC.W	PDOTQ-7
EXPEC	DC.W	DOCOL
	DC.W	OVER
	DC.W	PLUS
	DC.W	OVER
	DC.W	XDO	* DO
EXPE1	DC.W	KEY
	DC.W	DUP
	DC.W	BKSPK
	DC.W	AT
	DC.W	CEQU
	DC.W	ZBRAN	* IF
	DC.W	EXPE2-*
	DC.W	DROP
	DC.W	BKSPE
	DC.W	AT
	DC.W	OVER
	DC.W	RR	* IDO
	DC.W	EQUAL
	DC.W	DUP
	DC.W	FROMR
	DC.W	TWO
	DC.W	SUBB
	DC.W	PLUS
	DC.W	TOR
	DC.W	SUBB
	DC.W	BRAN	* IF
	DC.W	EXPE3-*
EXPE2	DC.W	DUP
	DC.W	LIT
	DC.W	$0D
	DC.W	CEQU
	DC.W	ZBRAN	* IF
	DC.W	EXPE4-*
	DC.W	LEAVE
	DC.W	DROP
	DC.W	BL
	DC.W	ZERO
	DC.W	BRAN	* ELSE
	DC.W	EXPE5-*
EXPE4	DC.W	DUP	* ENDIF
EXPE5	DC.W	RR	* IDO
	DC.W	CSTOR
	DC.W	ZERO
	DC.W	RR	* IDO
	DC.W	ONEP
	DC.W	CSTOR	* ENDIF
EXPE3	DC.W	EMIT
	DC.W	XLOOP	* LOOP
	DC.W	EXPE1-*
	DC.W	DROP
	DC.W	SEMIS
*
	DC.B	$85	* QUERY
	DC.B	'QUER'
	DC.B	$80+'Y'
	DC.W	EXPEC-$09
QUERY	DC.W	DOCOL
	DC.W	TIB
	DC.W	AT
	DC.W	LIT
	DC.W	$50
	DC.W	EXPEC
	DC.W	ZERO
	DC.W	INN
	DC.W	STORE
	DC.W	SEMIS
*
	DC.B	$C1	* 0 (NULL)
	DC.B	$80
	DC.W	QUERY-8
NULL	DC.W	DOCOL
	DC.W	BLK
	DC.W	AT
	DC.W	ZBRAN	* IF
	DC.W	NULL1-*
	DC.W	ONE
	DC.W	BLK
	DC.W	PSTOR
	DC.W	ZERO
	DC.W	INN
	DC.W	STORE
	DC.W	BLK
	DC.W	AT
	DC.W	BSCR
	DC.W	ONE
	DC.W	SUBB
	DC.W	ANDD
	DC.W	ZEQU
	DC.W	ZBRAN	* I8
	DC.W	NULL2-*
	DC.W	QEXEC
	DC.W	FROMR
	DC.W	DROP	* ENDIF
NULL2	DC.W	BRAN	* ELSE
	DC.W	NULL3-*
NULL1	DC.W	FROMR
	DC.W	DROP	* ENDIFF
NULL3	DC.W	SEMIS
*
	DC.B	$85	* ERASE
	DC.B	'ERAS'
	DC.B	$80+'E'
	DC.W	NULL-4
ERASEE	DC.W	DOCOL
	DC.W	ZERO
	DC.W	FILL
	DC.W	SEMIS
*
	DC.B	0,$86	* BLANKS
	DC.B	'BLANK'
	DC.B	$80+'S'
	DC.W	ERASEE-8
BLANK	DC.W	DOCOL
	DC.W	BL
	DC.W	FILL
	DC.W	SEMIS
*
	DC.B	0,$84	* HOLD
	DC.B	'HOL'
	DC.B	$80+'D'
	DC.W	BLANK-$09
HOLD	DC.W	DOCOL
	DC.W	LIT
	DC.W	0-1
	DC.W	HLD
	DC.W	PSTOR
	DC.W	HLD
	DC.W	AT
	DC.W	CSTOR
	DC.W	SEMIS
*
	DC.B	$83	* PAD
	DC.B	'PA'
	DC.B	$80+'D'
	DC.W	HOLD-7
PAD	DC.W	DOCOL
	DC.W	HERE
	DC.W	LIT
	DC.W	$44
	DC.W	PLUS
	DC.W	SEMIS
*
	DC.B	0,$84	* WORD
	DC.B	'WOR'
	DC.B	$80+'D'
	DC.W	PAD-6
WORD	DC.W	DOCOL
	DC.W	BLK
	DC.W	AT
	DC.W	ZBRAN	* IF
	DC.W	WORD1-*
	DC.W	BLK
	DC.W	AT
	DC.W	BLOCK
	DC.W	BRAN	* ELSE
	DC.W	WORD2-*
WORD1	DC.W	TIB
	DC.W	AT
*  	*ENDIF
WORD2	DC.W	INN
	DC.W	AT
	DC.W	PLUS
	DC.W	SWAP
	DC.W	ENCL
	DC.W	HERE
	DC.W	LIT
	DC.W	$22
	DC.W	BLANK
	DC.W	INN
	DC.W	PSTOR
	DC.W	OVER
	DC.W	SUBB
	DC.W	TOR
	DC.W	RR
	DC.W	HERE
	DC.W	CSTOR
	DC.W	PLUS
	DC.W	HERE
	DC.W	ONEP
	DC.W	FROMR
	DC.W	CMOVE
	DC.W	SEMIS
*
	DC.B	0,$88	* (NUMBER)
	DC.B	'(NUMBER'
	DC.B	$80+')'
	DC.W	WORD-7
PNUMB	DC.W	DOCOL
REP SET *	* BEGIN	
	DC.W	ONEP
	DC.W	DUP
	DC.W	TOR
	DC.W	CAT
	DC.W	BASE
	DC.W	AT
	DC.W	DIGIT
	DC.W	ZBRAN	* WHILE
	DC.W	PNUM2-*
	DC.W	SWAP
	DC.W	BASE
	DC.W	AT
	DC.W	USTAR
	DC.W	DROP
	DC.W	ROT
	DC.W	BASE
	DC.W	AT
	DC.W	USTAR
	DC.W	DPLUS
	DC.W	DPL
	DC.W	AT
	DC.W	ONEP
	DC.W	ZBRAN	* IF
	DC.W	PNUM3-*
	DC.W	ONE
	DC.W	DPL
	DC.W	PSTOR	* ENDIF
PNUM3	DC.W	FROMR
	DC.W	BRAN	* REPEAT
	DC.W	REP-*
PNUM2	DC.W	FROMR
	DC.W	SEMIS
*
	DC.B	0,$86	* NUMBER
	DC.B	'NUMBE'
	DC.B	$80+'R'
	DC.W	PNUMB-$0B
NUMB	DC.W	DOCOL
	DC.W	ZERO
	DC.W	ZERO
	DC.W	ROT
	DC.W	DUP
	DC.W	ONEP
	DC.W	CAT
	DC.W	LIT
	DC.W	$2D
	DC.W	EQUAL
	DC.W	DUP
	DC.W	TOR
	DC.W	PLUS
	DC.W	LIT
	DC.W	0-1
REP SET *	* BEGIN
	DC.W	DPL
	DC.W	STORE
	DC.W	PNUMB
	DC.W	DUP
	DC.W	CAT
	DC.W	BL '
	DC.W	SUBB
	DC.W	ZBRAN	* WHILE
	DC.W	NUMB2-*
	DC.W	DUP
	DC.W	CAT
	DC.W	LIT
	DC.W	$2E
	DC.W	SUBB
	DC.W	ZERO
	DC.W	QERR
	DC.W	ZERO
	DC.W	BRAN	* REPEAT
	DC.W	REP-*
NUMB2	DC.W	DROP
	DC.W	FROMR
	DC.W	ZBRAN
*   IF
	DC.W	NUMB3-*
	DC.W	DMINU	* ENDIF
NUMB3	DC.W	SEMIS
*
	DC.B	$85	* -FIND (0-3) SUCCESS
	DC.B	'-FIN'	* (0-1) FAILURE
	DC.B	$80+'D'
	DC.W	NUMB-$09
DFIND	DC.W	DOCOL
	DC.W	BL
	DC.W	WORD
	DC.W	HERE
	DC.W	CONT
	DC.W	AT
	DC.W	AT
	DC.W	PFIND
	DC.W	DUP
	DC.W	ZEQU
	DC.W	ZBRAN	* IF
	DC.W	DFIN1-*
	DC.W	DROP
	DC.W	HERE
	DC.W	LATES
	DC.W	PFIND	* ENDIF
DFIN1	DC.W	SEMIS
*F
*F	DC.B	$87	* (ABORT)
*F	DC.B	'(ABORT'
*F	DC.B	$80+')'
*F	DC.W	DFIND-8
*F  PABOR	DC.W	DOCOL
*F	DC.W	ABORT
*F	DC.W	SEMIS
*
	DC.B	$85	* ERROR
	DC.B	'ERRO'
	DC.B	$80+'R'
	DC.W	DFIND-8
ERROR	DC.W	DOCOL
	DC.W	WARN
	DC.W	AT
	DC.W	ZLESS
	DC.W	ZBRAN	* IF
	DC.W	ERRO1-*
	DC.W	ABORT	* ENDIF
ERRO1	DC.W	HERE
	DC.W	COUNT
	DC.W	TYPE
	DC.W	PDOTQ
	DC.B	3
	DC.B	'  ?'
	DC.W	MESS
	DC.W	SPSTO
	DC.W	INN,AT,BLK,AT
	DC.W	QUIT
	DC.W	SEMIS
*
	DC.B	$83	* MIN
	DC.B	'MI'
	DC.B	$80+'N'
	DC.W	ERROR-8
MIN	DC.W	DOCOL,OVER,OVER
	DC.W	GREAT
	DC.W	ZBRAN	* IF
	DC.W	MIN1-*
	DC.W	SWAP	* ENDIF
MIN1	DC.W	DROP
	DC.W	SEMIS
*
	DC.B	$83	* ID.
	DC.B	'ID'
	DC.B	$80+'.'
	DC.W	MIN-6
IDDOT	DC.W	DOCOL
	DC.W	PAD
	DC.W	LIT
	DC.W	$20
	DC.W	LIT
	DC.W	$5F
	DC.W	FILL
	DC.W	DUP
	DC.W	PFA
	DC.W	LFA
	DC.W	OVER
	DC.W	SUBB
	DC.W	PAD
	DC.W	SWAP
	DC.W	CMOVE
	DC.W	PAD
	DC.W	COUNT
	DC.W	LIT
	DC.W	$001F
	DC.W	ANDD
	DC.W	TYPE
	DC.W	SPACE
	DC.W	SEMIS
*
	DC.B	0,$86	* CREATE
	DC.B	'CREAT'
	DC.B	$80+'E'
	DC.W	IDDOT-6
CREAT	DC.W	DOCOL
	DC.W	DICTL	* ADDITION
	DC.W	AT
	DC.W	HERE
	DC.W	LIT,$30
	DC.W	PLUS
	DC.W	LESS
	DC.W	TWO,QERR
	DC.W	DFIND
	DC.W	ZBRAN	* IF
	DC.W	CREA1-*
	DC.W	DROP
	DC.W	NFA
	DC.W	IDDOT
	DC.W	LIT,4
	DC.W	MESS
	DC.W	SPACE	* ENDIF
CREA1	DC.W	HERE	* ADDITION
	DC.W	DUP
	DC.W	CAT
	DC.W	XORR
	DC.W	ONE
	DC.W	ANDD
	DC.W	ZEQU
	DC.W	ZBRAN
	DC.W	CREA2-*
	DC.W	HERE
	DC.W	DUP
	DC.W	DUP
	DC.W	ONEP
	DC.W	OVER
	DC.W	CAT
	DC.W	ONEP
	DC.W	CMOVE
	DC.W	ZERO
	DC.W	SWAP
	DC.W	CSTOR
	DC.W	ONE
	DC.W	ALLOT
CREA2	DC.W	HERE
	DC.W	DUP
	DC.W	CAT
	DC.W	WIDTH
	DC.W	AT
	DC.W	MIN
	DC.W	ONEP
	DC.W	ALLOT
	DC.W	DUP
	DC.W	LIT,$A0
	DC.W	TOGGL
	DC.W	HERE
	DC.W	ONE
	DC.W	SUBB
	DC.W	LIT,$80
	DC.W	TOGGL
	DC.W	LATES
	DC.W	COMMA
	DC.W	CURR
	DC.W	AT
	DC.W	STORE
	DC.W	HERE
	DC.W	TWOP
	DC.W	COMMA
	DC.W	SEMIS
*
	DC.B	$C1	* :(COLON)
	DC.B	$80+':'
	DC.W	CREAT-$09
COLON	DC.W	DOCOL
	DC.W	QEXEC,SCSP,CURR
	DC.W	AT,CONT,STORE
	DC.W	CREAT,RBRAC
	DC.W	LIT
	DC.W	0-2
	DC.W	DP,PSTOR
	DC.W	COMP,DOCOL,SEMIS
*
	DC.B	$85	* SCODE
	DC.B	'!COD'
	DC.B	$80+'E'
	DC.W	COLON-$4
SCODE	DC.W	DOCOL
	DC.W	CREAT
	DC.W	SMUDG
	DC.W	LATES
	DC.W	PFA
	DC.W	CFA
	DC.W	STORE
	DC.W	COMMA
	DC.W	SEMIS
*
	DC.B	0,$88	* CONSTANT
	DC.B	'CONSTAN'
	DC.B	$80+'T'
	DC.W	SCODE-8
CONST	DC.W	DOCOL
	DC.W	LIT,DOCON
	DC.W	SCODE
	DC.W	SEMIS
*
	DC.B	0,$88	* VARIABLE
	DC.B	'VARIABL'
	DC.B	$80+'E'
	DC.W	CONST-$0B
VARIA	DC.W	DOCOL
	DC.W	LIT,DOVAR
	DC.W	SCODE
	DC.W	SEMIS
*
	DC.B	0,$84	* USER
	DC.B	'USE'
	DC.B	$80+'R'
	DC.W	VARIA-$0B
USER	DC.W	DOCOL
	DC.W	LIT,DOUSE
	DC.W	SCODE
	DC.W	SEMIS
*
	DC.B	$87	* <BUILDS
	DC.B	'<BUILD'
	DC.B	$80+'S'
	DC.W	USER-7
BUILD	DC.W	DOCOL
	DC.W	ZERO
	DC.W	CONST
	DC.W	SEMIS
*
	DC.B	$85	* DOES>
	DC.B	'DOES'
	DC.B	$80+'>'
	DC.W	BUILD-$0A
DOES	DC.W	DOCOL
	DC.W	FROMR
	DC.W	LATES
	DC.W	PFA
	DC.W	STORE
	DC.W	PSCOD
DODOE	MOVE.W	A4,-(A7)
	MOVE.W	(A5)+,A4
	MOVE.W	A5,-(A3)
	MOVE.W	(A4)+,A5
	MOVE.W	(A5)+,A0
	JMP	(A0)
*
	DC.B	$C7	* LITERAL
	DC.B	'LITERA'
	DC.B	$80+'L'
	DC.W	DOES-$08
LITER	DC.W	DOCOL
	DC.W	STATE
	DC.W	AT
	DC.W	ZBRAN	* IF
	DC.W	LITE1-*
	DC.W	COMP
	DC.W	LIT
	DC.W	COMMA	* ENDIF
LITE1	DC.W	SEMIS
*
	DC.B	0,$C8	* DLITERAL
	DC.B	'DLITERA'
	DC.B	$80+'L'
	DC.W	LITER-$0A
DLITE	DC.W	DOCOL
	DC.W	STATE
	DC.W	AT
	DC.W	ZBRAN	* IF
	DC.W	DLIT1-*
	DC.W	SWAP
	DC.W	LITER
	DC.W	LITER 	* ENDIF
DLIT1	DC.W	SEMIS
*
	DC.B	0,$86	* ?STACK
	DC.B	'?STAC'
	DC.B	$80+'K'
	DC.W	DLITE-$0B
QSTAC	DC.W	DOCOL
	DC.W	SZERO
	DC.W	AT
	DC.W	DUP
	DC.W	SPAT
	DC.W	LESS
	DC.W	ONE
	DC.W	QERR
	DC.W	LIT
	DC.W	$100
	DC.W	PLUS
	DC.W	SPAT
	DC.W	LESS
	DC.W	LIT
	DC.W	7
	DC.W	QERR
	DC.W	SEMIS
*
	DC.B	$89	* INTERPRET
	DC.B	'INTERPRE'
	DC.B	$80+'T'
	DC.W	QSTAC-$09
INTER	DC.W	DOCOL
REP SET *	*BEGIN
	DC.W	DFIND
	DC.W	ZBRAN	* IF
	DC.W	INTE2-*
	DC.W	STATE
	DC.W	AT
	DC.W	LESS
	DC.W	ZBRAN	* IF
	DC.W	INTE3-*
	DC.W	CFA
	DC.W	COMMA
	DC.W	BRAN	* ELSE
	DC.W	INTE4-*
INTE3	DC.W	CFA
	DC.W	EXEC 	* ENDIF
INTE4	DC.W	QSTAC
	DC.W	BRAN	* ELSE
	DC.W	INTE5-*
INTE2	DC.W	HERE
	DC.W	NUMB
	DC.W	DPL
	DC.W	AT
	DC.W	ONEP
	DC.W	ZBRAN	* IF
	DC.W	INTE6-*
	DC.W	DLITE
	DC.W	BRAN	* ELSE
	DC.W	INTE7-*
INTE6	DC.W	DROP
	DC.W	LITER 	* ENDIF
INTE7	DC.W	QSTAC 	* ENDIF
INTE5	DC.W	BRAN	* AGAIN
	DC.W	REP-*
	DC.W	SEMIS
*
	DC.B	0,$8A	* VOCABULARY
	DC.B	'VOCABULAR'
	DC.B	$80+'Y'
	DC.W	INTER-$0C
VOCAB	DC.W	DOCOL
	DC.W	BUILD
	DC.W	LIT
	DC.W	$81A0	* FAKE HEADER
	DC.W	COMMA
	DC.W	CURR
	DC.W	AT
	DC.W	CFA
	DC.W	COMMA
	DC.W	HERE
	DC.W	VOCL
	DC.W	AT
	DC.W	COMMA
	DC.W	VOCL
	DC.W	STORE
	DC.W	DOES
DOVOC	DC.W	TWOP
	DC.W	CONT
	DC.W	STORE
	DC.W	SEMIS
*
	DC.B	$C5	* FORTH
	DC.B	'FORT'
	DC.B	$80+'H'
	DC.W	VOCAB-$0D
FORTH	DC.W	DODOE
	DC.W	DOVOC
	DC.W	$81A0
 
	DC.W	DR0-6	* COLD START VALUE ONLY
*     CHANGED EACH TIME A DEF IS APPENDED
*     TO THE FORTH VOCABULARY
VCLINK	DC.W	0000	* END OF VOCABULARY LIST
*
	DC.B	$8B	* DEFINITIONS
	DC.B	'DEFINITION'
	DC.B	$80+'S'
	DC.W	FORTH-8
DEFIN	DC.W	DOCOL
	DC.W	CONT
	DC.W	AT
	DC.W	CURR
	DC.W	STORE
	DC.W	SEMIS
*
	DC.B	0,$84	* QUIT
	DC.B	'QUI'
	DC.B	$80+'T'
	DC.W	DEFIN-$0E
QUIT	DC.W	DOCOL
	DC.W	ZERO
	DC.W	BLK
	DC.W	STORE
	DC.W	LBRAC
REP SET *	*BEGIN
	DC.W	RPSTO
	DC.W	CR
	DC.W	QUERY
	DC.W	INTER
	DC.W	STATE
	DC.W	AT
	DC.W	ZEQU
	DC.W	ZBRAN	* IF
	DC.W	QUIT2-*
	DC.W	PDOTQ
	DC.B	5
	DC.B	'   OK'	* ENDIF
QUIT2	DC.W	BRAN	* AGAIN
	DC.W	REP-*
	DC.W	SEMIS
*
	DC.B	$85	* ABORT
	DC.B	'ABOR'
	DC.B	$80+'T'
	DC.W	QUIT-7
ABORT	DC.W	DOCOL
	DC.W	SPSTO
	DC.W	DEC
*F	DC.W	QSTAC
	DC.W	CR
*F	DC.W	DOTCPU
	DC.W	PDOTQ
	DC.B	$15
	DC.B	'68000 fig-FORTH V'
	DC.B	FIGREL+'0'
	DC.B	'.'
	DC.B	FIGREV+'0'
	DC.B	' '
	DC.W	FORTH
	DC.W	DEFIN
	DC.W	DR0
	DC.W	QUIT
	DC.W	SEMIS
*
	DC.B	$C1	*	;
	DC.B	$80+';'
	DC.W	ABORT-8
SEMI	DC.W	DOCOL
	DC.W	QCSP
	DC.W	COMP
	DC.W	SEMIS
	DC.W	SMUDG 
	DC.W	LBRAC
	DC.W	SEMIS
*
	DC.B	0,$C2	* ."
	DC.B	'.'
	DC.B	$80+'"'
	DC.W	SEMI-4
DOTQ	DC.W	DOCOL
	DC.W	LIT
	DC.W	$22
	DC.W	STATE
	DC.W	AT
	DC.W	ZBRAN	* IF
	DC.W	DOTQ1-*
	DC.W	COMP
	DC.W	PDOTQ
	DC.W	WORD
	DC.W	HERE
	DC.W	CAT
	DC.W	TWOP
	DC.W	LIT
	DC.W	$FFFE
	DC.W	ANDD
	DC.W	ALLOT
	DC.W	BRAN	* ELSE
	DC.W	DOTQ2-*
DOTQ1	DC.W	WORD
	DC.W	HERE
	DC.W	COUNT
	DC.W	TYPE	* ENDIF
DOTQ2	DC.W	SEMIS
*
	DC.B	$C1	* BRA
	DC.B	$80+'('
	DC.W	DOTQ-5
BRA	DC.W	DOCOL
	DC.W	LIT
	DC.B	0
	DC.B	')'
	DC.W	WORD
	DC.W	SEMIS
*
	DC.B	$89	* IMMEDIATE
	DC.B	'IMMEDIAT'
	DC.B	$80+'E'
	DC.W	BRA-4
IMMED	DC.W	DOCOL
	DC.W	LATES
	DC.W	LIT,$40
	DC.W	TOGGL
	DC.W	SEMIS
*
	DC.B	$C9	* [COMPILE]
	DC.B	'[COMPILE'
	DC.B	$80+']'
	DC.W	IMMED-$0C
BCOMP	DC.W	DOCOL
	DC.W	DFIND
	DC.W	ZEQU
	DC.W	ZERO
	DC.W	QERR
	DC.W	DROP
	DC.W	CFA
	DC.W	COMMA
	DC.W	SEMIS
*
	DC.B	$C1	* '   ( TICK )
	DC.B	$A7
	DC.W	BCOMP-$0C
TICK	DC.W	DOCOL
	DC.W	DFIND
	DC.W	ZEQU
	DC.W	ZERO
	DC.W	QERR
	DC.W	DROP
	DC.W	LITER
	DC.W	SEMIS
*
	DC.B	0,$86	* FORGET
	DC.B	'FORGE'
	DC.B	$80+'T'
	DC.W	TICK-4
FORG	DC.W	DOCOL
	DC.W	CURR,AT
	DC.W	CONT,AT
	DC.W	SUBB
	DC.W	LIT,$18
	DC.W	QERR
	DC.W	TICK
	DC.W	DUP
	DC.W	FENCE
	DC.W	AT
	DC.W	LESS
	DC.W	LIT,$15
	DC.W	QERR
	DC.W	DUP
	DC.W	NFA
	DC.W	DP,STORE
	DC.W	LFA,AT
	DC.W	CURR,AT,STORE
	DC.W	SEMIS
*
	DC.B	0,$84	* BACK
	DC.B	'BAC'
	DC.B	$80+'K'
	DC.W	FORG-$09
BACK	DC.W	DOCOL
	DC.W	HERE
	DC.W	SUBB
	DC.W	COMMA
	DC.W	SEMIS
*
	DC.B	$C5	* BEGIN
	DC.B	'BEGI'
	DC.B	$80+'N'
	DC.W	BACK-7
BEGIN	DC.W	DOCOL
	DC.W	QCOMP
	DC.W	HERE
	DC.W	ONE
	DC.W	SEMIS
*
	DC.B	$C5	* ENDIF
	DC.B	'ENDI'
	DC.B	$80+'F'
	DC.W	BEGIN-8
ENDIFF	DC.W	DOCOL
	DC.W	QCOMP
	DC.W	TWO,QPAIR
	DC.W	HERE
	DC.W	OVER
	DC.W	SUBB
	DC.W	SWAP
	DC.W	STORE
	DC.W	SEMIS
*
	DC.B	0,$C4	* THEN
	DC.B	'THE'
	DC.B	$80+'N'
	DC.W	ENDIFF-8
THEN	DC.W	DOCOL
	DC.W	ENDIFF
	DC.W	SEMIS
*
	DC.B	0,$C2	* DO
	DC.B	'D'
	DC.B	$80+'O'
	DC.W	THEN-7
DO	DC.W	DOCOL
	DC.W	COMP
	DC.W	XDO
	DC.W	HERE
	DC.W	THREE
	DC.W	SEMIS
*
	DC.B	0,$C4	* LOOP
	DC.B	'LOO'
	DC.B	$80+'P'
	DC.W	DO-5
LOOP	DC.W	DOCOL
	DC.W	THREE,QPAIR
	DC.W	COMP
	DC.W	XLOOP
	DC.W	BACK
	DC.W	SEMIS
*
	DC.B	$C5	* +LOOP
	DC.B	'+LOO'
	DC.B	$80+'P'
	DC.W	LOOP-7
PLOOP	DC.W	DOCOL
	DC.W	THREE,QPAIR
	DC.W	COMP
	DC.W	XPLOO
	DC.W	BACK
	DC.W	SEMIS
*
	DC.B	$C5	* UNTIL
	DC.B	'UNTI'
	DC.B	$80+'L'
	DC.W	PLOOP-8
UNTIL	DC.W	DOCOL
	DC.W	ONE,QPAIR
	DC.W	COMP
	DC.W	ZBRAN,BACK
	DC.W	SEMIS
*
	DC.B	$C3	* END
	DC.B	'EN'
	DC.B	$80+'D'
	DC.W	UNTIL-8
ENDD	DC.W	DOCOL
	DC.W	UNTIL
	DC.W	SEMIS
*
	DC.B	$C5	* AGAIN
	DC.B	'AGAI'
	DC.B	$80+'N'
	DC.W	ENDD-6
AGAIN	DC.W	DOCOL
	DC.W	ONE,QPAIR
	DC.W	COMP
	DC.W	BRAN,BACK
	DC.W	SEMIS
*
	DC.B	0,$C6	* REPEAT
	DC.B	'REPEA'
	DC.B	$80+'T'
	DC.W	AGAIN-8
REPEA	DC.W	DOCOL
	DC.W	TOR,TOR
	DC.W	AGAIN
	DC.W	FROMR
	DC.W	FROMR
	DC.W	TWO
	DC.W	SUBB
	DC.W	ENDIFF,SEMIS
*
	DC.B	0,$C2	* IF
	DC.B	'I'
	DC.B	$80+'F'
	DC.W	REPEA-$09
IFF	DC.W	DOCOL
	DC.W	COMP
	DC.W	ZBRAN
	DC.W	HERE
	DC.W	ZERO
	DC.W	COMMA
	DC.W	TWO,SEMIS
*
	DC.B	0,$C4	* ELSE
	DC.B	'ELS'
	DC.B	$80+'E'
	DC.W	IFF-5
ELSEE	DC.W	DOCOL,TWO
	DC.W	QPAIR,COMP
	DC.W	BRAN,HERE
	DC.W	ZERO,COMMA
	DC.W	SWAP,TWO
	DC.W	ENDIFF,TWO
	DC.W	SEMIS
*
	DC.B	$C5	* WHILE
	DC.B	'WHIL'
	DC.B	$80+'E'
	DC.W	ELSEE-7
WHILE	DC.W	DOCOL,IFF
	DC.W	TWOP,SEMIS
*
	DC.B	0,$82	* +-
	DC.B	'+'
	DC.B	$80+'-'
	DC.W	WHILE-8
PM	DC.W	DOCOL
	DC.W	ZLESS
	DC.W	ZBRAN	* IF
	DC.W	PM1-*
	DC.W	MINUS 	* ENDIF
PM1	DC.W	SEMIS
*
	DC.B	$83	* D+-
	DC.B	'D+'
	DC.B	$80+'-'
	DC.W	PM-5
DPM	DC.W	DOCOL
	DC.W	ZLESS
	DC.W	ZBRAN	* IF
	DC.W	DPM1-*
	DC.W	DMINU 	* ENDIF
DPM1	DC.W	SEMIS
*
	DC.B	$83	* ABS
	DC.B	'AB'
	DC.B	$80+'S'
	DC.W	DPM-6
ABS	DC.W	DOCOL
	DC.W	DUP
	DC.W	PM
	DC.W	SEMIS
*
	DC.B	0,$84	* DABS
	DC.B	'DAB'
	DC.B	$80+'S'
	DC.W	ABS-6
DABS	DC.W	DOCOL
	DC.W	DUP
	DC.W	DPM
	DC.W	SEMIS
*
	DC.B	$83	* MAX
	DC.B	'MA'
	DC.B	$80+'X'
	DC.W	DABS-7
MAX	DC.W	DOCOL,OVER,OVER
	DC.W	LESS
	DC.W	ZBRAN	* IF
	DC.W	MAX1-*
	DC.W	SWAP 	* ENDIF
MAX1	DC.W	DROP
	DC.W	SEMIS
*
	DC.B	0,$82	* M*
	DC.B	'M'
	DC.B	$80+'*'
	DC.W	MAX-6
MSTAR	DC.W	DOCOL,OVER,OVER
	DC.W	XORR
	DC.W	TOR
	DC.W	ABS
	DC.W	SWAP
	DC.W	ABS
	DC.W	USTAR
	DC.W	FROMR
	DC.W	DPM
	DC.W	SEMIS
*
	DC.B	0,$82	* M/
	DC.B	'M'
	DC.B	$80+'/'
	DC.W	MSTAR-5
MSLAS	DC.W	DOCOL
	DC.W	OVER
	DC.W	TOR
	DC.W	TOR
	DC.W	DABS
	DC.W	RR
	DC.W	ABS
	DC.W	USLAS
	DC.W	FROMR
	DC.W	RR
	DC.W	XORR
	DC.W	PM
	DC.W	SWAP
	DC.W	FROMR
	DC.W	PM
	DC.W	SWAP
	DC.W	SEMIS
*
	DC.B	$81	* *
	DC.B	$80+'*'
	DC.W	MSLAS-5
STAR	DC.W	DOCOL
	DC.W	USTAR
	DC.W	DROP
	DC.W	SEMIS
*
	DC.B	0,$84	* /MOD
	DC.B	'/MO'
	DC.B	$80+'D'
	DC.W	STAR-4
SLMOD	DC.W	DOCOL
	DC.W	TOR
	DC.W	STOD
	DC.W	FROMR
	DC.W	MSLAS
	DC.W	SEMIS
*
	DC.B	$81	* /
	DC.B	$80+'/'
	DC.W	SLMOD-7
SLASH	DC.W	DOCOL
	DC.W	SLMOD
	DC.W	SWAP
	DC.W	DROP
	DC.W	SEMIS
*
	DC.B	$83	* MOD
	DC.B	'MO'
	DC.B	$80+'D'
	DC.W	SLASH-4
MODD	DC.W	DOCOL
	DC.W	SLMOD
	DC.W	DROP
	DC.W	SEMIS
*
	DC.B	$85	* */MOD
	DC.B	'*/MO'
	DC.B	$80+'D'
	DC.W	MODD-6
SSMOD	DC.W	DOCOL
	DC.W	TOR
	DC.W	MSTAR
	DC.W	FROMR
	DC.W	MSLAS
	DC.W	SEMIS
*
	DC.B	0,$82	* */
	DC.B	'*'
	DC.B	$80+'/'
	DC.W	SSMOD-8
SSLA	DC.W	DOCOL
	DC.W	SSMOD
	DC.W	SWAP
	DC.W	DROP
	DC.W	SEMIS
*
	DC.B	$85	* M/MOD
	DC.B	'M/MO'
	DC.B	$80+'D'
	DC.W	SSLA-5
MSMOD	DC.W	DOCOL
	DC.W	TOR
	DC.W	ZERO
	DC.W	RR
	DC.W	USLAS
	DC.W	FROMR
	DC.W	SWAP
	DC.W	TOR
	DC.W	USLAS
	DC.W	FROMR
	DC.W	SEMIS
*
	DC.B	0,$86	* SPACES
	DC.B	'SPACE'
	DC.B	$80+'S'
	DC.W	MSMOD-8
SPACS	DC.W	DOCOL,ZERO
	DC.W	MAX,DDUP
	DC.W	ZBRAN	* IF
	DC.W	SPAX1-*
	DC.W	ZERO,XDO	* DO
SPAX2	DC.W	SPACE
	DC.W	XLOOP 	* LOOP ENDIF
	DC.W	SPAX2-*
SPAX1	DC.W	SEMIS
*
	DC.B	0,$82	* <#
	DC.B	'<'
	DC.B	$80+'#'
	DC.W	SPACS-$09
BDIGS	DC.W	DOCOL,PAD
	DC.W	HLD,STORE
	DC.W	SEMIS
*
	DC.B	0,$82	* #>
	DC.B	'#'
	DC.B	$80+'>'
	DC.W	BDIGS-5
EDIGS	DC.W	DOCOL,DROP
	DC.W	DROP,HLD
	DC.W	AT,PAD
	DC.W	OVER,SUBB
	DC.W	SEMIS
*
	DC.B	0,$84	* SIGN
	DC.B	'SIG'
	DC.B	$80+'N'
	DC.W	EDIGS-5
SIGN	DC.W	DOCOL,ROT
	DC.W	ZLESS
	DC.W	ZBRAN	* IF
	DC.W	SIGN1-*
	DC.W	LIT,$2D
	DC.W	HOLD 	* ENDIF
SIGN1	DC.W	SEMIS
*
	DC.B	$81	* #
	DC.B	$80+'#'
	DC.W	SIGN-7
DIG	DC.W	DOCOL,BASE
	DC.W	AT,MSMOD
	DC.W	ROT,LIT,9
	DC.W	OVER,LESS
	DC.W	ZBRAN	* IF
	DC.W	DIG1-*
	DC.W	LIT,7
	DC.W	PLUS 	* ENDIF
DIG1	DC.W	LIT,$30
	DC.W	PLUS,HOLD
	DC.W	SEMIS
*
	DC.B	0,$82	* #S
	DC.B	'#'
	DC.B	$80+'S'
	DC.W	DIG-4
DIGS	DC.W	DOCOL
REP SET *	*BEGIN
	DC.W	DIG
	DC.W	OVER,OVER
	DC.W	ORR,ZEQU
	DC.W	ZBRAN	* UNTIL
	DC.W	REP-*
	DC.W	SEMIS
*
	DC.B	$83	* D.R
	DC.B	'D.'
	DC.B	$80+'R'
	DC.W	DIGS-5
DDOTR	DC.W	DOCOL,TOR
	DC.W	SWAP,OVER
	DC.W	DABS,BDIGS
	DC.W	DIGS,SIGN
	DC.W	EDIGS,FROMR
	DC.W	OVER,SUBB
	DC.W	SPACS,TYPE
	DC.W	SEMIS
*
	DC.B	0,$82	* D.
	DC.B	'D'
	DC.B	$80+'.'
	DC.W	DDOTR-6
DDOT	DC.W	DOCOL,ZERO
	DC.W	DDOTR,SPACE
	DC.W	SEMIS
*
	DC.B	0,$82	* .R
	DC.B	'.'
	DC.B	$80+'R'
	DC.W	DDOT-5
DOTR	DC.W	DOCOL,TOR
	DC.W	STOD,FROMR
	DC.W	DDOTR,SEMIS
*
*
	DC.B	$81	* .
	DC.B	$80+'.'
	DC.W	DOTR-5
DOT	DC.W	DOCOL,STOD
	DC.W	DDOT,SEMIS
*
	DC.B	$81	* ?
	DC.B	$80+'?'
	DC.W	DOT-4
QUES	DC.W	DOCOL
	DC.W	AT
	DC.W	DOT
	DC.W	SEMIS
*F
*F	DC.B	0,$82	* U.
*F	DC.B	'U'
*F	DC.B	$80+'.'
*F	DC.W	QUES-4
*F UDOT	DC.W	DOCOL,ZERO
*F	DC.W	DDOT,SEMIS
*
	DC.B	$85	* VLIST
	DC.B	'VLIS'
	DC.B	$80+'T'
	DC.W	QUES-4
VLIST	DC.W	DOCOL,LIT,$80
	DC.W	OUTT,STORE
	DC.W	CONT
	DC.W	AT,AT
REP SET *	*BEGIN
	DC.W	OUTT
	DC.W	AT,CSLL
	DC.W	GREAT
	DC.W	ZBRAN	* IF
	DC.W	VLIS2-*
	DC.W	CR,LIT,$0E
	DC.W	OUTT
	DC.W	STORE 	* ENDIF
VLIS2	DC.W	DUP
	DC.W	IDDOT,SPACE
	DC.W	SPACE,PFA
	DC.W	LFA,AT
	DC.W	DUP,ZEQU
	DC.W	QTERM
	DC.W	ORR
	DC.W	ZBRAN	* UNTIL
	DC.W	REP-*
	DC.W	DROP,SEMIS
*
* --------------------------------------------------
* DISK INTERFACE HIGH-LEVEL ROUTINES
*
	DC.B	0,$84	* +BUF  ( ADVANCE BUFFER )
	DC.B	'+BU'
	DC.B	$80+'F'
	DC.W	VLIST-8
PBUF	DC.W	DOCOL
	DC.W	BBUF
	DC.W	LIT,4,PLUS
	DC.W	PLUS,DUP
	DC.W	LIMIT,EQUAL
	DC.W	ZBRAN
	DC.W	PBUF1-*
	DC.W	DROP,FIRST
PBUF1	DC.W	DUP,PREV
	DC.W	AT,SUBB
	DC.W	SEMIS

	DC.B	0,$86	* UPDATE
	DC.B	'UPDAT'
	DC.B	$80+'E'
	DC.W	PBUF-7
UPDAT	DC.W	DOCOL,PREV
	DC.W	AT,AT
	DC.W	LIT,$8000
	DC.W	ORR
	DC.W	PREV,AT
	DC.W	STORE,SEMIS
*
	DC.B	$8D	* EMPTY-BUFFERS
	DC.B	'EMPTY-BUFFER'
	DC.B	$80+'S'
	DC.W	UPDAT-$09
MTBUF	DC.W	DOCOL,FIRST
	DC.W	LIMIT,OVER
	DC.W	SUBB,ERASEE
	DC.W	SEMIS
*
	DC.B	0,$86	* BUFFER
	DC.B	'BUFFE'
	DC.B	$80+'R'
	DC.W	MTBUF-$10
BUFFE	DC.W	DOCOL,USE
	DC.W	AT,DUP
	DC.W	TOR
REP SET *	*BEGIN
	DC.W	PBUF 	* WON'T WORK IF SINGLE BUFFER
	DC.W	ZBRAN
	DC.W	REP-*	* UNTIL
	DC.W	USE,STORE
	DC.W	RR,AT
	DC.W	ZLESS
	DC.W	ZBRAN
	DC.W	BUFF2-*
	DC.W	RR,TWOP
	DC.W	RR,AT
	DC.W	LIT,$7FFF
	DC.W	ANDD,ZERO
	DC.W	RSLW
BUFF2	DC.W	RR,STORE
	DC.W	RR,PREV
	DC.W	STORE,FROMR
	DC.W	TWOP,SEMIS
*
	DC.B	$85	* BLOCK
	DC.B	'BLOC'
	DC.B	$80+'K'
	DC.W	BUFFE-$09
BLOCK	DC.W	DOCOL,OFSET
	DC.W	AT,PLUS
	DC.W	TOR,PREV
	DC.W	AT,DUP
	DC.W	AT,RR
	DC.W	SUBB
	DC.W	DUP,PLUS
	DC.W	ZBRAN	* IF
	DC.W	BLOC1-*
REP SET *	*BEGIN
	DC.W	PBUF,ZEQU
	DC.W	ZBRAN
	DC.W	BLOC3-*	*IF
	DC.W	DROP,RR
	DC.W	BUFFE,DUP
	DC.W	RR,ONE
	DC.W	RSLW
	DC.W	TWO,SUBB	*ENDIF
BLOC3	DC.W	DUP,AT
	DC.W	RR,SUBB
	DC.W	DUP,PLUS
	DC.W	ZEQU
	DC.W	ZBRAN
	DC.W	REP-*	* UNTIL
	DC.W	DUP,PREV
	DC.W	STORE
BLOC1	DC.W	FROMR,DROP
	DC.W	TWOP,SEMIS
*
	DC.B	0,$86	* (LINE)
	DC.B	'(LINE'
	DC.B	$80+')'
	DC.W	BLOCK-8
PLINE	DC.W	DOCOL
	DC.W	TOR
	DC.W	CSLL
	DC.W	BBUF
	DC.W	SSMOD
	DC.W	FROMR
	DC.W	BSCR
	DC.W	STAR
	DC.W	PLUS
	DC.W	BLOCK
	DC.W	PLUS
	DC.W	CSLL
	DC.W	SEMIS
*
	DC.B	$85	* .LINE
	DC.B	'.LIN'
	DC.B	$80+'E'
	DC.W	PLINE-$09
DLINE	DC.W	DOCOL
	DC.W	PLINE
	DC.W	DTRAI
	DC.W	TYPE
	DC.W	SEMIS
*
	DC.B	$87	* MESSAGE
	DC.B	'MESSAG'
	DC.B	$80+'E'
	DC.W	DLINE-8
MESS	DC.W	DOCOL
	DC.W	WARN
	DC.W	AT
	DC.W	ZBRAN	* IF
	DC.W	MESS1-*
	DC.W	DDUP
	DC.W	ZBRAN	* IF
	DC.W	MESS2-*
	DC.W	LIT,4
	DC.W	OFSET
	DC.W	AT
	DC.W	BSCR
	DC.W	SLASH
	DC.W	SUBB
	DC.W	DLINE 	* ENDIF
MESS2	DC.W	BRAN	* ELSE
	DC.W	MESS3-*
MESS1	DC.W	PDOTQ
	DC.B	5
	DC.B	'MSG #'
	DC.W	DOT 	* ENDIF
MESS3	DC.W	SEMIS
*
*F FLUSH	DC.W	DOCOL
*F	DC.W	NOBUF,ONEP
*F	DC.W	ZERO,XDO
*F FLUS1	DC.W	ZERO,BUFFE
*F	DC.W	DROP
*F	DC.W	XLOOP
*	DC.W	FLUS1-*
*F	DC.W	SEMIS
	DC.B	0,$84	* LOAD
	DC.B	'LOA'
	DC.B	$80+'D'
	DC.W	MESS-$0A
LOAD	DC.W	DOCOL,BLK
	DC.W	AT,TOR
	DC.W	INN,AT
	DC.W	TOR,ZERO
	DC.W	INN,STORE
	DC.W	BSCR,STAR
	DC.W	BLK,STORE	* BLK <- SCR * B/SCR
	DC.W	INTER 	* INTERPRET FROM OTHER SCREEN
	DC.W	FROMR,INN
	DC.W	STORE
	DC.W	FROMR,BLK
	DC.W	STORE
	DC.W	SEMIS
*
	DC.B	$C3	* -->
	DC.B	'--'
	DC.B	$80+'>'
	DC.W	LOAD-7
ARROW	DC.W	DOCOL
	DC.W	QLOAD
	DC.W	ZERO
	DC.W	INN
	DC.W	STORE
	DC.W	BSCR
	DC.W	BLK
	DC.W	AT
	DC.W	OVER
	DC.W	MODD
	DC.W	SUBB
	DC.W	BLK
	DC.W	PSTOR
	DC.W	SEMIS
*
	DC.B	0,$84	* LIST
	DC.B	'LIS'
	DC.B	$80+'T'
	DC.W	ARROW-6
LIST	DC.W	DOCOL,DEC
	DC.W	CR,DUP
	DC.W	SCR,STORE
	DC.W	PDOTQ
	DC.B	5
	DC.B	'SCR #'
	DC.W	DOT
	DC.W	LIT,$10
	DC.W	ZERO,XDO
LIST1	DC.W	CR,RR	*IDO
	DC.W	THREE
	DC.W	DOTR,SPACE
	DC.W	RR,SCR	*IDO
	DC.W	AT,DLINE
*F	DC.W	QTERM
*F	DC.W	ZBRAN,LIST2-*	* ?TERMINAL IF
*F	DC.W	LEAVE 	* LEAVE
LIST2	DC.W	XLOOP	* ENDIF
	DC.W	LIST1-*
	DC.W	CR,SEMIS
*
	DC.B	$85	* INDEX
	DC.B	'INDE'
	DC.B	$80+'X'
	DC.W	LIST-7
INDEX	DC.W	DOCOL
	DC.W	CR
	DC.W	ONEP,SWAP
	DC.W	XDO
INDE1	DC.W	CR,RR 	* IDO
	DC.W	THREE
	DC.W	DOTR,SPACE
	DC.W	ZERO,RR 	* IDO
	DC.W	DLINE,QTERM
	DC.W	ZBRAN
	DC.W	INDE2-*
	DC.W	LEAVE
INDE2	DC.W	XLOOP
	DC.W	INDE1-*
	DC.W	SEMIS
*F
*F	DC.B	$85	* TRIAD
*F	DC.B	'TRIA'
*F	DC.B	$80+'D'
*F	DC.W	INDEX-8
*F TRIAD	DC.W	DOCOL,LIT,FF
*F	DC.W	EMIT,LIT,3
*F	DC.W	SLASH,LIT,3
*F	DC.W	STAR,LIT,3
*F	DC.W	OVER,PLUS
*F	DC.W	SWAP,XDO
*F TRIA1	DC.W	CR,IDO
*F	DC.W	LIST,QTERM	* ?TERMINAL
*F	DC.W	ZBRAN,TRIA2-*	*IF
*F	DC.W	LEAVE 	* LEAVE
*F TRIA2	DC.W	XLOOP,TRIA1-*
*F     ENDIF
*F	DC.W	CR,LIT,15
*F	DC.W	MESS,CR,SEMIS
*F
*F	DC.B	0,$84	* .CPU
*F	DC.B	'.CP'
*F	DC.B	$80+'U'
*F	DC.W	TRIAD-8
*F DOTCPU	DC.W	DOCOL,BASE,AT
*F	DC.W	LIT,36
*F	DC.W	BASE,STORE
*F	DC.W	LIT,$22
*F	DC.W	PORIG,TAT
*F	DC.W	DDOT
*F	DC.W	BASE,STORE,SEMIS
*F
*F	DC.B	0,$84	* TASK
*F	DC.B	'TAS'
*F	DC.B	$80+'K'
*F	DC.W	DOTCPU-7
*F TASK	DC.W	DOCOL,SEMIS
*F
*F	DC.B	0,$84	* WARM
*F	DC.B	'WAR'
*F	DC.B	$80+'M'
*F	DC.W	INDEX-8
*F WARM	DC.W	DOCOL
*F	DC.W	MTBUF
*F	DC.W	ABORT
*
	DC.B	0,$84	* COLD
	DC.B	'COL'
	DC.B	$80+'D'
	DC.W	INDEX-8
COLD	DC.W	2+*
	MOVE.W	#COLDUS,A0	* BOOTLIST
	MOVE.W	(A0),$2F00	* TOP NFA
	MOVE.W	4(A0),A6	* SET USER POINTER REG
	MOVE.W	A6,A1 		* WORK COPY OF USER PNTR
	MOVE.W	#$0A,D0		* MOVE ELEVEN BOOTUPS
COLD1	MOVE.W	(A0)+,(A1)+	* ONE AT A TIME
	DBF	D0,COLD1	* UNTIL DONE,
	ADD.W	#$1E,A1		* POINT TO BYTE US+34
	MOVE.W	#$0D,D0		* MOVE 14 MORE BOOTUPS
COLD2	MOVE.W	(A0)+,(A1)+	* ONE AT A TIME
	DBF	D0,COLD2	* UNTIL DONE
	MOVE.W	$36(A6),D0	* GET LIMIT
	MOVE.W	$34(A6),A0	* GET FIRST
	SUB.W	A0,D0 		* CALC BUFFER AREA BYTES
	SUBQ.W	#1,D0 		* LOOP PREDECREMENT
COLD3	MOVE.B	#0,(A0)+	* FILL AREA WITH 00
	DBF	D0,COLD3	* UNTIL DONE
	BRA.S	GFRTH
WARM	DC.W	$3C78,COLDUS+4	* THE ASSEMBLER COULD NOT HANDLE THE NEXT
				* INSTRUCTION FOLLOWING MANTEI
				* BECAUSE COLDUS+4 IS A FORWARD REFERENCE
*	MOVE.W	COLDUS+4.W,A6	* SET USER
GFRTH	MOVE.W	#ABORT+2,A4	* SET IP REGISTER
	JMP	RPSTO+2 	* JUMP TO RP! CODE
*
COLDUS	DC.W	DR0-6
	DC.W	BSIN	* BKSPKEY, DEPENDS ON KEYBOARD
	DC.W	USPAG	* USER PAGE
	DC.W	INITS0	* COMPUTATION STACK
	DC.W	INITR0	* RETURN STACK
	DC.W	BUFE	* TIB
	DC.W	$001F	* WIDTH
	DC.W	$0000	* WARNING
	DC.W	INITDP	* COLD FENCE
	DC.W	INITDP	* DP
	DC.W	VCLINK	* VOC-LINK SHOULD NOT BE CHANGED
	DC.W	BM	* FIRST
	DC.W	BUFE	* LIMIT
	DC.W	BM	* USED
	DC.W	BM	* PREV
	DC.W	EM	* DICTLIMIT
	DC.W	BSOUT	* BKSPEMIT,COULD NEED CHANGE
	DC.W	XEMIT	* ADDRESS OF EMIT CODE SUBROUTINE
	DC.W	XKEY	* IDEM OF KEY
	DC.W	XQTERM	* IDEM OF ?TERMINAL
	DC.W	XCR	* IDEM OF CR
	DC.W	XRSLW	* IDEM OF R/W
	DC.W	KBBUF	* B/BUF
	DC.W	BSCRN	* B/SCR
	DC.W	$0040	* C/L
*
	DC.B	$83	* R/W  ( FORTH DISK PRIMATIVE )
	DC.B	'R/'
	DC.B	$80+'W'
	DC.W	COLD-7
RSLW	DC.W	2+*
	MOVE.W	72(A6),A0
	JSR	(A0)
	MOVE.W	(A4)+,A5
	MOVE.W	(A5)+,A0
	JMP	(A0)
*
*-------------------------------------------------------
*
* ALTERNATIVE R/W IF TOTALLY IN CORE
*
*RSLW	DC.W	DOCOL
*	DC.W	DROP,DROP,DROP
*	DC.W	SEMIS
*
*--------------------------------------------------------
*
	DC.B	0,$86	* ORIGIN
	DC.B	'ORIGI'
	DC.B	$80+'N'
	DC.W	RSLW-6
ORIG	DC.W	DOCON
	DC.W	COLDUS-$0C
*
	DC.B	$87	* +ORIGIN
	DC.B	'+ORIGI'
	DC.B	$80+'N'
	DC.W	ORIG-$09
PORIG	DC.W	DOCOL
	DC.W	ORIG
	DC.W	PLUS
	DC.W	SEMIS
*
	DC.B	$83	* DR0
	DC.B	'DR'
	DC.B	$80+'0'
	DC.W	PORIG-$0A
DR0	DC.W	DOCOL
	DC.W	ZERO
	DC.W	OFSET
	DC.W	STORE
	DC.W	SEMIS
*
INITDP	EQU	*	* START OF USER DICTIONARY
*
*	  MEMORY MAP
* THE FOLLOWING EQUATES ARE NOT REFERENCED ELSEWHERE )
* IT IS INTENDED FOR THE USER OF THE FORTH SYSTEM
*
*		LOCATION 	CONTENTS
*  		--------        --------
MCOLD	EQU	COLD+2 		*COLD START ENTRY POINT
MWARM	EQU	WARM 		*WARM START ENTRY POINT
*MA2	EQU	COLDUS 		*COLD START PARAMETERS
* 68000 REGISTER A6		*USER VARIABLES' BASE 'REG'
* 68000 REGISTER A7 		*RETURN STACK 'REGISTER'
*
* NO 'NEXT' ENTRY BECAUSE THE ADDRESS INTERPRETER IS
*  APPENDED TO EACH INSTRUCTION
* ALSO NO DEBUG SUPPORT ENTRY
*
MFIRST	EQU	BM		*START DISK BUFFERS
*MEND	EQU	BUFE		*END DISK BUFFERS
				* (5TH USER VARIABLE)
				* = (TIB)
				* I  TERMINAL INPUT
				* I  BUFFER
				* V
				* A (A3 POINTS HERE)
				* I
				* I  USER STACK
*MISO	EQU	INITS0		* COLD (SP) VALUE = (S0)
				* (3TH USER VARIABLE)
*MUSPAG	EQU	USPAG		* A6 POINTS HERE
				* I  USER VARIABLES
				* V
				* A (A7 POINTS HERE)
				* I
				* I RETURN STACK
*MIRO	EQU	INITR0		* COLD (RP) VALUE = (R0)
				*
*MIO	EQU	IOARE		* (ROOM LEFT FOR I/O ROUTINES)
				*
*MDP0	EQU	DP0		* START FORTH DICTIONARY
*MIDP	EQU	*		* END INITIAL FORTH DICTIONARY
				* = COLD (DP) VALUE
				* = COLD (FENCE) VALUE
				* I  NEW
				* I  DEFINITIONS
				* V
*MLIMIT	EQU	EM		* LAST MEMORY LOC USED + 1
				* = [COLDUS+$1A]	
*
*
*
	END


